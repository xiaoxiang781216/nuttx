## libs/libc/assert/Kconfig
```kconfig
#
# For a description of the syntax of this configuration file,
# see the file kconfig-language.txt in the NuttX tools repository.
#

menu "lib_assert custom options"

config LIBC_ASSERT_CUSTOM
	bool "use custom implementation of __assert"
	default n
	---help---
		If the default implementation of __assert cannot match requirements,
		Possible remove the default implementation and use a custom one.

endmenu #lib_assert custom options
```

## libs/libc/errno/Kconfig
```kconfig
#
# For a description of the syntax of this configuration file,
# see the file kconfig-language.txt in the NuttX tools repository.
#

menu "lib_errno custom options"

config LIBC_ERRNO_CUSTOM
	bool "use custom implemantation of errno"
	default n
	---help---
		If the default implemantation of errno cannot match requirements,
		Possible remove the default implementation and use a custom one.

endmenu #lib_errno custom options
```

## libs/libc/tls/Kconfig
```kconfig
#
# For a description of the syntax of this configuration file,
# see the file kconfig-language.txt in the NuttX tools repository.
#

menu "Thread Local Storage (TLS)"

config TLS_NELEM
	int "Number of TLS elements"
	depends on !DISABLE_PTHREAD
	default 0
	range 0 255
	---help---
		The number of unique TLS elements.  These can be accessed with
		the user library functions tls_get_value() and tls_set_value()
		and the OS interfaces tls_alloc() and tls_free().

		NOTE that the special value of CONFIG_TLS_NELEM disables these
		TLS interfaces.

config TLS_TASK_NELEM
	int "Number of Task Local Storage elements"
	depends on !BUILD_KERNEL
	default 0
	range 0 255
	---help---
		The number of unique Task Local Storage elements similar with
		Thread Local Storage.
		These can be accessed with task_tls_alloc/task_tls_get_value/task_tls_set_value.
		NOTE that the 0 value of CONFIG_SCHED_TLS_NELEM disables these
		TLS interfaces.

config TLS_NCLEANUP
	int "Number of cleanup stack levels"
	default 0
	range 0 255
	---help---
		The number of cleanup stack levels.  These are used to support
		POSIX pthread cancellation.  The number of cleanup stack levels
		is the maximum number of pthread_cleanup_push() calls that can
		be made without a corresponding pthread_cleanup_pop() call.

endmenu # Thread Local Storage (TLS)
```
