## fs/zipfs/Kconfig
```kconfig
#
# For a description of the syntax of this configuration file,
# see the file kconfig-language.txt in the NuttX tools repository.
#

config FS_ZIPFS
	bool "ZIP File System"
	depends on UTILS_LIBARCHIVE
	default n

if FS_ZIPFS

config FS_ZIPFS_BUFFER_SIZE
	int "Buffer size"
	default 32768
	---help---
		libarchive requires a buffer to read and write data.

config FS_ZIPFS_FORMAT_ALL
	bool "support zip all format"
	default n
	---help---
		All format support will increase binary size.
if !FS_ZIPFS_FORMAT_ALL
config FS_ZIPFS_FORMAT_ZIP
	bool "support zip xar format"
	default y

config FS_ZIPFS_FORMAT_7ZIP
	bool "support zip 7zip format"
	default n

config FS_ZIPFS_FORMAT_AR
	bool "support zip ar format"
	default n

config FS_ZIPFS_FORMAT_CAB
	bool "support zip cab format"
	default n

config FS_ZIPFS_FORMAT_CPIO
	bool "support zip cpio format"
	default n

config FS_ZIPFS_FORMAT_EMTY
	bool "support zip emty format"
	default n

config FS_ZIPFS_FORMAT_ISO9660
	bool "support zip iso9660 format"
	default n

config FS_ZIPFS_FORMAT_LHA
	bool "support zip lha format"
	default n

config FS_ZIPFS_FORMAT_MTREE
	bool "support zip mtree format"
	default n

config FS_ZIPFS_FORMAT_RAR
	bool "support zip rar format"
	default n

config FS_ZIPFS_FORMAT_RAR_V5
	bool "support zip rar_v5 format"
	default n

config FS_ZIPFS_FORMAT_RAW
	bool "support zip raw format"
	default n

config FS_ZIPFS_FORMAT_TAR
	bool "support zip raw format"
	default n

config FS_ZIPFS_FORMAT_WARC
	bool "support zip warc format"
	default n

config FS_ZIPFS_FORMAT_XAR
	bool "support zip xar format"
	default n

endif

endif

config FS_ZIPFS_WRITE
	bool "wzipfs write-only streaming filesystem"
	depends on UTILS_LIBARCHIVE
	default n
	---help---
		Write-only streaming mount type "wzipfs". Independent of FS_ZIPFS;
		a board may enable either, both, or neither.

		Mount an empty file (or FIFO/socket) and writes to the mount point
		are encoded as ZIP bytes directly into the backing target.
		umount emits the central directory + EOCD.

		Mount option: method=store (default) or method=deflate.

		Fixed RAM overhead: ~69 KB baseline + ~100-160 B per written file.
		Unsuitable for devices with < 128 KB heap.

if FS_ZIPFS_WRITE

config FS_ZIPFS_WRITE_DEFLATE
	bool "wzipfs: DEFLATE compression"
	default n
	depends on LIB_ZLIB
	---help---
		Enable method=deflate mount option. Adds ~260 KB zlib workspace
		when DEFLATE is selected at mount time.
		Default method remains STORE (uncompressed) even when this is y.

endif
```

## libs/libc/fuse/Kconfig
```kconfig
#
# For a description of the syntax of this configuration file,
# see the file kconfig-language.txt in the NuttX tools repository.
#

config LIBC_FS_FUSE
	bool "FUSE/CUSE userspace library"
	default n
	depends on FS_FUSE
	---help---
		The in-tree libfuse-compatible userspace library:  a from-scratch
		high-level (fuse_operations) and low-level (fuse_lowlevel_ops)
		implementation plus CUSE support, driving the kernel FUSE core
		through /dev/fuse and /dev/cuse.  The same engine also serves
		the vhost-fs host driver (CONFIG_DRIVERS_VHOST_FS) through the
		fuse_custom_io transport.

if LIBC_FS_FUSE

config LIBC_FS_FUSE_MAX_WRITE
	int "FUSE/CUSE write buffer size"
	default 4096
	---help---
		The maximum payload in one write transaction

config LIBC_FS_FUSE_STACKSIZE
	int "FUSE/CUSE worker thread stack size"
	default PTHREAD_STACK_DEFAULT
	depends on !DISABLE_PTHREAD && EVENT_FD_POLL
	---help---
		Stack size of the worker threads created by fuse_session_loop_mt().

endif
```

## libs/libc/machine/arm/Kconfig
```kconfig
#
# For a description of the syntax of this configuration file,
# see the file kconfig-language.txt in the NuttX tools repository.
#

config ARM_TARGET2_PREL
	bool "R_ARM_TARGET2 is PC relative"
	default CXX_EXCEPTION
	depends on LIBC_ARCH_ELF
	---help---
		Perform a PC relative relocation for relocation type R_ARM_TARGET2

config ARM_STRING_FUNCTION
	bool "Enable optimized ARM specific string functions"
	default n
	depends on ARCH_TOOLCHAIN_GNU
	select ARM_MEMCHR
	select ARM_MEMCPY
	select ARM_MEMSET
	select ARM_MEMMOVE
	select ARM_STRCMP
	select ARM_STRCPY
	select ARM_STRLEN

config ARM_MEMCHR
	bool "Enable optimized memchr() for ARM"
	default n
	select LIBC_ARCH_MEMCHR
	depends on ARCH_TOOLCHAIN_GNU
	---help---
		Enable optimized ARM specific memchr() library function

config ARM_MEMCPY
	bool "Enable optimized memcpy() for ARM"
	default n
	select LIBC_ARCH_MEMCPY
	depends on ARCH_TOOLCHAIN_GNU
	---help---
		Enable optimized ARM specific memcpy() library function

config ARM_MEMSET
	bool "Enable optimized memset() for ARM"
	default n
	select LIBC_ARCH_MEMSET
	depends on ARCH_TOOLCHAIN_GNU
	---help---
		Enable optimized ARM specific memset() library function

config ARM_MEMMOVE
	bool "Enable optimized memmove() for ARM"
	default n
	select LIBC_ARCH_MEMMOVE
	depends on ARCH_TOOLCHAIN_GNU
	---help---
		Enable optimized ARM specific memmove() library function

config ARM_STRCMP
	bool "Enable optimized strcmp() for ARM"
	default n
	select LIBC_ARCH_STRCMP
	depends on ARCH_TOOLCHAIN_GNU
	---help---
		Enable optimized ARM specific strcmp() library function

config ARM_STRCPY
	bool "Enable optimized strcpy() for ARM"
	default n
	select LIBC_ARCH_STRCPY
	depends on ARCH_TOOLCHAIN_GNU
	---help---
		Enable optimized ARM specific strcpy() library function

config ARM_STRLEN
	bool "Enable optimized strlen() for ARM"
	default n
	select LIBC_ARCH_STRLEN
	depends on ARCH_TOOLCHAIN_GNU
	---help---
		Enable optimized ARM specific strlen() library function

config LIBC_ARCH_CRC32
	bool "Enable optimized crc32 for ARM"
	default n
	depends on ARCH_HAVE_CRC32
	---help---
		Enable optimized arm neon specific crc32 library function
```

## libs/libc/machine/arm/arm_a_r/Kconfig
```kconfig
#
# For a description of the syntax of this configuration file,
# see the file kconfig-language.txt in the NuttX tools repository.
#

if ARCH_ARM_A_R

config ARM_A_R_STRING_FUNCTION
	bool "Enable optimized ARM A/R specific string function"
	default n
	depends on ARCH_TOOLCHAIN_GNU
	select ARM_A_R_MEMCHR
	select ARM_A_R_MEMCPY
	select ARM_A_R_MEMMOVE
	select ARM_A_R_MEMSET
	select ARM_A_R_STRCMP
	select ARM_A_R_STRLEN

config ARM_A_R_MEMCHR
	bool "Enable optimized memchr() for ARM A/R"
	default n
	select LIBC_ARCH_MEMCHR
	depends on ARCH_TOOLCHAIN_GNU
	---help---
		Enable optimized ARM A/R specific memchr() library function

config ARM_A_R_MEMCPY
	bool "Enable optimized memcpy() for ARM A/R"
	default n
	select LIBC_ARCH_MEMCPY
	depends on ARCH_TOOLCHAIN_GNU
	---help---
		Enable optimized ARM A/R specific memcpy() library function

config ARM_A_R_MEMMOVE
	bool "Enable optimized memmove() for ARM A/R"
	default n
	select LIBC_ARCH_MEMMOVE
	depends on ARCH_TOOLCHAIN_GNU
	---help---
		Enable optimized ARM A/R specific memmove() library function

config ARM_A_R_MEMSET
	bool "Enable optimized memset() for ARM A/R"
	default n
	select LIBC_ARCH_MEMSET
	depends on ARCH_TOOLCHAIN_GNU
	---help---
		Enable optimized ARM A/R specific memset() library function

config ARM_A_R_STRCMP
	bool "Enable optimized strcmp() for ARM A/R"
	default n
	select LIBC_ARCH_STRCMP
	depends on ARCH_TOOLCHAIN_GNU
	---help---
		Enable optimized ARM A/R specific strcmp() library function

config ARM_A_R_STRLEN
	bool "Enable optimized strlen() for ARM A/R"
	default n
	select LIBC_ARCH_STRLEN
	depends on ARCH_TOOLCHAIN_GNU
	---help---
		Enable optimized ARM A/R specific strlen() library function

endif
```

## libs/libc/machine/arm/arm_m/Kconfig
```kconfig
#
# For a description of the syntax of this configuration file,
# see the file kconfig-language.txt in the NuttX tools repository.
#

config ARM_TARGET2_PREL
	bool "R_ARM_TARGET2 is PC relative"
	default CXX_EXCEPTION
	depends on LIBC_ARCH_ELF
	---help---
		Perform a PC relative relocation for relocation type R_ARM_TARGET2

if ARCH_ARM_M

config ARM_M_STRING_FUNCTION
	bool "Enable optimized ARM-M specific string functions"
	default n
	depends on ARCH_TOOLCHAIN_GNU
	select ARM_M_MEMCHR
	select ARM_M_MEMCPY
	select ARM_M_MEMSET
	select ARM_M_MEMMOVE
	select ARM_M_STRCMP
	select ARM_M_STRCPY
	select ARM_M_STRLEN

config ARM_M_MEMCHR
	bool "Enable optimized memchr() for ARM-M"
	default n
	select LIBC_ARCH_MEMCHR
	depends on ARCH_TOOLCHAIN_GNU
	---help---
		Enable optimized ARM-M specific memchr() library function

config ARM_M_MEMCPY
	bool "Enable optimized memcpy() for ARM-M"
	default n
	select LIBC_ARCH_MEMCPY
	depends on ARCH_TOOLCHAIN_GNU
	---help---
		Enable optimized ARM-M specific memcpy() library function

config ARM_M_MEMSET
	bool "Enable optimized memset() for ARM-M"
	default n
	select LIBC_ARCH_MEMSET
	depends on ARCH_TOOLCHAIN_GNU
	---help---
		Enable optimized ARM-M specific memset() library function

config ARM_M_MEMMOVE
	bool "Enable optimized memmove() for ARM-M"
	default n
	select LIBC_ARCH_MEMMOVE
	depends on ARCH_TOOLCHAIN_GNU
	---help---
		Enable optimized ARM-M specific memmove() library function

config ARM_M_STRCMP
	bool "Enable optimized strcmp() for ARM-M"
	default n
	select LIBC_ARCH_STRCMP
	depends on ARCH_TOOLCHAIN_GNU
	---help---
		Enable optimized ARM-M specific strcmp() library function

config ARM_M_STRCPY
	bool "Enable optimized strcpy() for ARM-M"
	default n
	select LIBC_ARCH_STRCPY
	depends on ARCH_TOOLCHAIN_GNU
	---help---
		Enable optimized ARM-M specific strcpy() library function

config ARM_M_STRLEN
	bool "Enable optimized strlen() for ARM-M"
	default n
	select LIBC_ARCH_STRLEN
	depends on ARCH_TOOLCHAIN_GNU
	---help---
		Enable optimized ARM-M specific strlen() library function

# Backward compatibility: old ARMv7-M config names

config ARMV7M_STRING_FUNCTION
	bool "Enable optimized ARMv7M specific string function (deprecated, use ARM_M_STRING_FUNCTION)"
	default n
	depends on ARCH_TOOLCHAIN_GNU && ARCH_ARMV7M
	select ARM_M_STRING_FUNCTION

config ARMV7M_MEMCHR
	bool "Enable optimized memchr() for ARMv7-M (deprecated, use ARM_M_MEMCHR)"
	default n
	depends on ARCH_TOOLCHAIN_GNU && ARCH_ARMV7M
	select ARM_M_MEMCHR

config ARMV7M_MEMCPY
	bool "Enable optimized memcpy() for ARMv7-M (deprecated, use ARM_M_MEMCPY)"
	default n
	depends on ARCH_TOOLCHAIN_GNU && ARCH_ARMV7M
	select ARM_M_MEMCPY

config ARMV7M_MEMSET
	bool "Enable optimized memset() for ARMv7-M (deprecated, use ARM_M_MEMSET)"
	default n
	depends on ARCH_TOOLCHAIN_GNU && ARCH_ARMV7M
	select ARM_M_MEMSET

config ARMV7M_MEMMOVE
	bool "Enable optimized memmove() for ARMv7-M (deprecated, use ARM_M_MEMMOVE)"
	default n
	depends on ARCH_TOOLCHAIN_GNU && ARCH_ARMV7M
	select ARM_M_MEMMOVE

config ARMV7M_STRCMP
	bool "Enable optimized strcmp() for ARMv7-M (deprecated, use ARM_M_STRCMP)"
	default n
	depends on ARCH_TOOLCHAIN_GNU && ARCH_ARMV7M
	select ARM_M_STRCMP

config ARMV7M_STRCPY
	bool "Enable optimized strcpy() for ARMv7-M (deprecated, use ARM_M_STRCPY)"
	default n
	depends on ARCH_TOOLCHAIN_GNU && ARCH_ARMV7M
	select ARM_M_STRCPY

config ARMV7M_STRLEN
	bool "Enable optimized strlen() for ARMv7-M (deprecated, use ARM_M_STRLEN)"
	default n
	depends on ARCH_TOOLCHAIN_GNU && ARCH_ARMV7M
	select ARM_M_STRLEN

# Backward compatibility: old ARMv8-M config names

config ARMV8M_STRING_FUNCTION
	bool "Enable optimized ARMv8M specific string function (deprecated, use ARM_M_STRING_FUNCTION)"
	default n
	depends on ARCH_TOOLCHAIN_GNU && ARCH_ARMV8M
	select ARM_M_STRING_FUNCTION

config ARMV8M_MEMCHR
	bool "Enable optimized memchr() for ARMv8-M (deprecated, use ARM_M_MEMCHR)"
	default n
	depends on ARCH_TOOLCHAIN_GNU && ARCH_ARMV8M
	select ARM_M_MEMCHR

config ARMV8M_MEMCPY
	bool "Enable optimized memcpy() for ARMv8-M (deprecated, use ARM_M_MEMCPY)"
	default n
	depends on ARCH_TOOLCHAIN_GNU && ARCH_ARMV8M
	select ARM_M_MEMCPY

config ARMV8M_MEMSET
	bool "Enable optimized memset() for ARMv8-M (deprecated, use ARM_M_MEMSET)"
	default n
	depends on ARCH_TOOLCHAIN_GNU && ARCH_ARMV8M
	select ARM_M_MEMSET

config ARMV8M_MEMMOVE
	bool "Enable optimized memmove() for ARMv8-M (deprecated, use ARM_M_MEMMOVE)"
	default n
	depends on ARCH_TOOLCHAIN_GNU && ARCH_ARMV8M
	select ARM_M_MEMMOVE

config ARMV8M_STRCMP
	bool "Enable optimized strcmp() for ARMv8-M (deprecated, use ARM_M_STRCMP)"
	default n
	depends on ARCH_TOOLCHAIN_GNU && ARCH_ARMV8M
	select ARM_M_STRCMP

config ARMV8M_STRCPY
	bool "Enable optimized strcpy() for ARMv8-M (deprecated, use ARM_M_STRCPY)"
	default n
	depends on ARCH_TOOLCHAIN_GNU && ARCH_ARMV8M
	select ARM_M_STRCPY

config ARMV8M_STRLEN
	bool "Enable optimized strlen() for ARMv8-M (deprecated, use ARM_M_STRLEN)"
	default n
	depends on ARCH_TOOLCHAIN_GNU && ARCH_ARMV8M
	select ARM_M_STRLEN

endif
```
