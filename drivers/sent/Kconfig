## net/netforward/Kconfig
```kconfig
#
# For a description of the syntax of this configuration file,
# see the file kconfig-language.txt in the NuttX tools repository.
#

config NET_FORWARD
	bool
	default n
	---help---
		Enable forwarding function.

if NET_FORWARD

config NET_FORWARD_NCALLBACKS
	int "Temporary cached forward callbacks max number"
	default 0
	---help---
		Default temporary cached forward callbacks max number for each
		device to avoid overconsumption. Zero means no limit.

config NET_FORWARD_NSTRUCT
	int "Number of pre-allocated forwarding structures"
	default 4
	---help---
		When packets are forwarded from on device to another, a structure
		must be allocated to hold the state of forwarding across several
		asynchronous events.  Those structures are pre-allocated for
		minimal, deterministic performance and to prevent hogging of memory
		(of course, that means that this value must be carefully selected
		for your application).  This setting defines the number of such pre-
		allocated structures.

		NOTE: This setting effectively puts a maximum on the number of
		packets that may be waiting to be forwarded from one network device
		to another.  CONFIG_IOB_NBUFFERS also limits the forward because the
		payload of the packet (up to the MSS) is retain in IOBs.

		WARNING: DO NOT set this setting to a value greater than or equal to
		CONFIG_IOB_NBUFFERS, otherwise it may consume all the IOB and let
		netdev fail to work.

config NET_FORWARD_ALLOC_STRUCT
	int "Dynamic forwarding structures allocation"
	default 1
	---help---
		When set to 0 all dynamic allocations are disabled

		When set to 1 a new forwarding structure will be allocated every
		time, and it will be free'd when no longer needed.

		Setting this to 2 or more will allocate the forwarding structures
		in batches (with batch size equal to this config). When a I/O buffer
		chain head is no longer needed, it will be returned to the free
		forwarding structures pool, and it will never be deallocated!

		Note: maximum number of allocated forwarding structures is limited
		to CONFIG_IOB_NBUFFERS - CONFIG_IOB_THROTTLE to avoid consuming all
		the IOBs.

endif # NET_FORWARD

config NET_IPFORWARD
	bool "Enable L2 forwarding"
	default n
	select NET_FORWARD
	---help---
		Enable forwarding of packets.  Packets received with IP addresses
		that are not supported by this platform will be forwarded to the
		appropriate network device.  Routing table support may be required.

config NET_IPFORWARD_BROADCAST
	bool "Forward broadcast/multicast packets"
	default n
	depends on NET_IPFORWARD
	---help---
		If selected, broadcast packets received on one network device will
		be forwarded though other network devices.

config NET_CANFORWARD
	bool "Enable CAN forward function"
	default n
	depends on NET_CAN
	select NET_FORWARD
	---help---
		Enable CAN forward function. Packets received will be forwarded to the
		appropriate network device. Routing table support is required.

if NET_CANFORWARD

config NET_CANFORWARD_HASH_BITS
	int "CAN gateway hash table bits (buckets = 2^N)"
	default 4
	range 3 7
	---help---
		Number of hash bits for per-device CAN gateway rule table.
		Larger values use more memory but reduce lookup time for
		exact-match rules.

		Buckets = 2^N, plus one wildcard bucket for partial-mask
		and inverted-filter rules.
		Memory per device = (2^N + 1) * 8 bytes.

		Recommended values:
		  3 (9 buckets,   72B) - few rules (<20)
		  4 (17 buckets, 136B) - typical (20~100 rules)
		  5 (33 buckets, 264B) - many rules (100~300)
		  6 (65 buckets, 520B) - heavy routing (300+)

config NET_CANFORWARD_ASYNC
	bool "Enable async CAN gateway forwarding"
	default n
	---help---
		Enable async forwarding for CAN gateway rules.
		When enabled, rules with CGW_FLAGS_CAN_ASYNC flag set in
		their flags field are forwarded asynchronously via a dedicated
		workqueue instead of being forwarded synchronously in the RX
		path. This reduces RX path latency for fan-out scenarios such
		as 1722-to-CAN. When disabled, all rules are forwarded
		synchronously (original behavior).

if NET_CANFORWARD_ASYNC

config NET_CANFORWARD_WORK_PRIORITY
	int "CAN gateway async forwarding work priority"
	default 200
	---help---
		Priority of the dedicated CAN gateway workqueue thread used
		for async forwarding. Must be lower than any real-time
		periodic task that must not be preempted (e.g. 1ms cyclic
		task at priority 201). Default 200 ensures the forwarding
		worker yields to such tasks while still running at a
		reasonably high priority.

config NET_CANFORWARD_WORK_STACKSIZE
	int "CAN gateway async forwarding work stack size"
	default DEFAULT_TASK_STACKSIZE
	---help---
		Stack size of the dedicated CAN gateway workqueue thread.

endif # NET_CANFORWARD_ASYNC

config NET_CANFORWARD_IEEE1722ACF
	bool "Enable ieee1722 acf function support"
	default n

config NET_IEEE1722ACF_CAN_RX_TIMESTAMP
	bool "Reuse CAN IOB receive timestamp for ACF CAN message"
	default n
	depends on NET_CANFORWARD_IEEE1722ACF && NET_TIMESTAMP
	---help---
		When enabled, the IEEE 1722 ACF CAN message timestamp will
		prefer the receive timestamp already carried in the source
		CAN IOB (io_time) if it is valid (non-zero).  This provides
		a more accurate timestamp when the CAN frame was received
		through a gateway route with hardware RX timestamping.
		If the IOB timestamp is not valid, it falls back to reading
		the stream PTP / system clock.

config NET_IEEE1722_PKTSIZE
	int "IEEE 1722 packet buffer size"
	default NET_ETH_PKTSIZE
	depends on NET_CANFORWARD_IEEE1722ACF
	range 0 NET_ETH_PKTSIZE
	---help---
		Packet buffer size for IEEE 1722 (Audio Video Bridging) packets.

endif # NET_CANFORWARD
```

## syscall/Kconfig
```kconfig
#
# For a description of the syntax of this configuration file,
# see the file kconfig-language.txt in the NuttX tools repository.
#

menuconfig LIB_SYSCALL
	bool "System call support"
	depends on ARCH_HAVE_SYSCALL && !BUILD_FLAT
	default n
	---help---
		Build in support for "system calls".  System calls are used to
		implement a call gate mechanism that can be be used to call from
		user code into the kernel.  This is only useful for user code that
		lies outside of the kernel such as when the BUILD_PROTECTED or
		BUILD_KERNEL builds are selected.

		This permits calls from user-mode code into kernel mode; the call
		gate will change the mode of operation from user to supervisor mode,
		then call into the OS code on behalf of the user-mode application.

		If if there are no privilege issues preventing the call, system
		calls may also be of value because it can eliminate the need for
		symbol tables when linking external modules to the NuttX base code.
		The selection will build libsyscall.  External modules can then link
		with libsyscall when they are built and they can call into the OS
		with no knowledge of the actual address in the OS.  In this case,
		they call into a proxy that is link with the external code; that
		proxy then marshals the call parameter and invokes the system call
		to accomplish the interface.

if LIB_SYSCALL

config SYS_NNEST
	int "Number of nested system calls"
	default 2
	---help---
		This is architecture dependent.  Most architectures allocate
		resources to manage a fixed, maximum number of nested system calls.
		A nested system call occurs in the following scenario:  (1) A non-
		privileged user thread executes a system call, (2) part of the
		system call processing cause a call back into the user space code,
		and (3) the user space code performs another system call.

		I don't believe that any nested system calls will occur in the
		current design so the default maximum nesting level of 2 should be
		more than sufficient.

config LIB_SYSCALL_FILES
	string "system call csv files"
	default ""
	---help---
		This allows users to define syscalls in flat, protected, or kernel
		build modes without modifying the original library syscalls or
		the reserved architecture-specific syscalls.
		It comes helpful when you have some custom libraries
		that require syscalls to trap into the kernel for privileged handling.
		Another senario is that ou need to perform simple benchmarking
		for context switching to inject test logic to verify proper user/kernel
		mode switching.
		With the custom syscall extension mechanism, you can meet these
		specialized requirements without altering the built-in or common syscalls.
		To use this feature, only need define one/more syscall CSV files and use
		';' to separate them.
		For the csv file format, please see syscals.csv for example.
		e.g. CONFIG_LIB_SYSCALL_FILES="<path relative to nuttx>/syscall_ext1.csv;
		<path relative to nuttx>/syscall_ext2.csv"

config LIB_PPCCALL
	bool "Protected Procedure Call"
	depends on BUILD_PROTECTED
	default n
	---help---
		This allows application in user or kernel to call the function that located
		at other applicatiopn.

config LIB_PPCCALL_FILES
	string "Protected Procedure Call CSV File Patch"
	depends on LIB_PPCCALL
	---help---
		This is the path to the CSV file that defines the custom functions
		for the protected procedure call mechanism. The CSV file format is same
		as the syscall CSV file.

endif # LIB_SYSCALL

config LIB_SYSCALL_WRAPPER
	bool "Wrap system call functions"
	default n
	depends on ARCH_HAVE_SYSCALL_HOOKS
	---help---
		Enable this option to wrap system call functions with some
		functions defined. Can use it to protect kernel. rise
		privilege to access kernel data.
```
