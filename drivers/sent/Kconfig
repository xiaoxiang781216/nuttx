## libs/libc/machine/xtensa/Kconfig
```kconfig
#
# For a description of the syntax of this configuration file,
# see the file kconfig-language.txt in the NuttX tools repository.
#

config XTENSA_STRING_FUNCTION
	bool "Enable optimized XTENSA specific string function"
	default n
	select XTENSA_MEMCPY
	select XTENSA_MEMMOVE
	select XTENSA_MEMSET
	select XTENSA_MEMCMP
	select XTENSA_MEMCHR
	select XTENSA_STRCMP
	select XTENSA_STRCPY
	select XTENSA_STRLEN
	select XTENSA_STRNCPY
	select XTENSA_STRCHR
	select XTENSA_STRRCHR
	select XTENSA_STRNCMP
	select XTENSA_STRNLEN
	select XTENSA_STRCHRNUL
	select XTENSA_STPCPY
	select XTENSA_STPNCPY
	select XTENSA_STRCAT

config XTENSA_MEMCPY
	bool "Enable optimized memcpy() for XTENSA"
	select LIBC_ARCH_MEMCPY
	---help---
		Enable optimized XTENSA specific memcpy() library function

config XTENSA_MEMMOVE
	bool "Enable optimized memmove() for XTENSA"
	select LIBC_ARCH_MEMMOVE
	---help---
		Enable optimized XTENSA specific memmove() library function

config XTENSA_MEMSET
	bool "Enable optimized memset() for XTENSA"
	select LIBC_ARCH_MEMSET
	---help---
		Enable optimized XTENSA specific memset() library function

config XTENSA_STRCMP
	bool "Enable optimized strcmp() for XTENSA"
	select LIBC_ARCH_STRCMP
	---help---
		Enable optimized XTENSA specific strcmp() library function

config XTENSA_STRCPY
	bool "Enable optimized strcpy() for XTENSA"
	select LIBC_ARCH_STRCPY
	---help---
		Enable optimized XTENSA specific strcpy() library function

config XTENSA_STRLEN
	bool "Enable optimized strlen() for XTENSA"
	select LIBC_ARCH_STRLEN
	---help---
		Enable optimized XTENSA specific strlen() library function

config XTENSA_STRNCPY
	bool "Enable optimized strncpy() for XTENSA"
	select LIBC_ARCH_STRNCPY
	---help---
		Enable optimized XTENSA specific strncpy() library function

config XTENSA_MEMCMP
	bool "Enable optimized memcmp() for XTENSA"
	select LIBC_ARCH_MEMCMP
	---help---
		Enable optimized XTENSA specific memcmp() library function

config XTENSA_MEMCHR
	bool "Enable optimized memchr() for XTENSA"
	select LIBC_ARCH_MEMCHR
	---help---
		Enable optimized XTENSA specific memchr() library function

config XTENSA_STRCHR
	bool "Enable optimized strchr() for XTENSA"
	select LIBC_ARCH_STRCHR
	---help---
		Enable optimized XTENSA specific strchr() library function

config XTENSA_STRRCHR
	bool "Enable optimized strrchr() for XTENSA"
	select LIBC_ARCH_STRRCHR
	---help---
		Enable optimized XTENSA specific strrchr() library function

config XTENSA_STRNCMP
	bool "Enable optimized strncmp() for XTENSA"
	select LIBC_ARCH_STRNCMP
	---help---
		Enable optimized XTENSA specific strncmp() library function

config XTENSA_STRNLEN
	bool "Enable optimized strnlen() for XTENSA"
	select LIBC_ARCH_STRNLEN
	---help---
		Enable optimized XTENSA specific strnlen() library function

config XTENSA_STRCHRNUL
	bool "Enable optimized strchrnul() for XTENSA"
	select LIBC_ARCH_STRCHRNUL
	---help---
		Enable optimized XTENSA specific strchrnul() library function

config XTENSA_STPCPY
	bool "Enable optimized stpcpy() for XTENSA"
	select LIBC_ARCH_STPCPY
	---help---
		Enable optimized XTENSA specific stpcpy() library function

config XTENSA_STPNCPY
	bool "Enable optimized stpncpy() for XTENSA"
	select LIBC_ARCH_STPNCPY
	---help---
		Enable optimized XTENSA specific stpncpy() library function

config XTENSA_STRCAT
	bool "Enable optimized strcat() for XTENSA"
	select LIBC_ARCH_STRCAT
	---help---
		Enable optimized XTENSA specific strcat() library function
```

## libs/libc/stream/Kconfig
```kconfig
#
# For a description of the syntax of this configuration file,
# see the file kconfig-language.txt in the NuttX tools repository.
#

menu "Stream C I/O"

if LIBC_LZF

config STREAM_LZF_BLOG
	int "Log2 of block size"
	default 10
	range 9 12
	---help---
		This stream uses two buffers of size a little more than
		(1 << CONFIG_STREAM_LZF_BLOG) to compress and decompress data in
		chunks. Slightly better compression should be obtainable with larger

		NOTE:  This is a pairing option for using the decompression tool,
		       chunks must match with compression

endif

config STREAM_BSPRINTF_EMBED_FORMAT
	bool "Self-contained bsprintf records"
	default DRIVERS_NOTERPMSG
	---help---
		Make lib_bsprintf() store the format string in the record itself,
		prefixed by the name of the image that packed it, instead of leaving
		the format string to be addressed by the reader:

			[prefix\0][fmt\0][arguments...]

		The address of a format string is meaningful just inside the image
		that packed the record, so a reader living anywhere else faults or
		prints garbage when it resolves that address. This happens whenever
		the reader is not the producer:

		- Another core reads the records forwarded by the noterpmsg driver.
		- Another image reads a note buffer that survived a warm restart,
		  where DRIVERS_NOTERAM_SECTION points at retained memory: a boot
		  stage (bootloader, OTA, recovery) packs a record and the image it
		  jumps to unpacks it.

		Enable this on such short lived images. Leave it disabled on images
		that use these records for high rate tracing, where the extra copy
		and the larger records do matter.

		The arguments are then always packed by parsing the format string, so
		the encoding no longer depends on the type word the caller derived at
		compile time, that is on DRIVERS_NOTE_STRIP_FORMAT for a note.

		Set STREAM_BSPRINTF_PREFIX to name the image, or the records are
		reported without a source name.

config STREAM_BSPRINTF_PREFIX
	string "Name of the image packing bsprintf records"
	depends on STREAM_BSPRINTF_EMBED_FORMAT
	default RPMSG_LOCAL_CPUNAME if RPMSG
	default LIBC_HOSTNAME if !RPMSG
	---help---
		Name of the image that packed a record, stored in the record and
		reported as a [prefix] tag when it is unpacked. Use something that
		identifies the producer to whoever reads the records: the core for a
		cross core reader ("ap", "cp"), the boot stage for an image that
		inherits a retained buffer ("ota", "recovery").

		Defaults to RPMSG_LOCAL_CPUNAME where there is rpmsg, which is what
		the noterpmsg driver used to store on its own. Leave it empty to keep
		self-contained records without naming their source.

config STREAM_OUT_BUFFER_SIZE
	int "Output stream buffer size"
	default 64

config STREAM_HEXDUMP_BUFFER_SIZE
	int "Output hexdump stream buffer size"
	default 128

config STREAM_BASE64_BUFFER_SIZE
	int "Output base64 stream buffer size"
	default 128

endmenu # Locale Support
```

## libs/libm/libm/arm/Kconfig
```kconfig
#
# For a description of the syntax of this configuration file,
# see the file kconfig-language.txt in the NuttX tools repository.
#

if ARCH_ARMV7M || ARCH_ARMV7A || ARCH_ARMV7R || ARCH_ARMV8M || ARCH_ARMV8R

config ARM_LIBM
	bool "Architecture specific FPU optimizations"
	default n
	select LIBM_ARCH_FABSF
	select LIBM_ARCH_SQRTF
	select LIBM_ARCH_FABS if ARCH_DPFPU
	select LIBM_ARCH_SQRT if ARCH_DPFPU
	select LIBM_ARCH_CEILF if ARCH_ARMV8M || ARCH_ARMV8R
	select LIBM_ARCH_FLOORF if ARCH_ARMV8M || ARCH_ARMV8R
	select LIBM_ARCH_NEARBYINTF if ARCH_ARMV8M || ARCH_ARMV8R
	select LIBM_ARCH_RINTF if ARCH_ARMV8M || ARCH_ARMV8R
	select LIBM_ARCH_ROUNDF if ARCH_ARMV8M || ARCH_ARMV8R
	select LIBM_ARCH_TRUNCF if ARCH_ARMV8M || ARCH_ARMV8R
	select LIBM_ARCH_CEIL if (ARCH_ARMV8M || ARCH_ARMV8R) && ARCH_DPFPU
	select LIBM_ARCH_FLOOR if (ARCH_ARMV8M || ARCH_ARMV8R) && ARCH_DPFPU
	select LIBM_ARCH_NEARBYINT if (ARCH_ARMV8M || ARCH_ARMV8R) && ARCH_DPFPU
	select LIBM_ARCH_RINT if (ARCH_ARMV8M || ARCH_ARMV8R) && ARCH_DPFPU
	select LIBM_ARCH_ROUND if (ARCH_ARMV8M || ARCH_ARMV8R) && ARCH_DPFPU
	select LIBM_ARCH_TRUNC if (ARCH_ARMV8M || ARCH_ARMV8R) && ARCH_DPFPU
	select LIBM_ARCH_FMINF if ARCH_ARMV8M || ARCH_ARMV8R
	select LIBM_ARCH_FMAXF if ARCH_ARMV8M || ARCH_ARMV8R
	select LIBM_ARCH_FMIN if (ARCH_ARMV8M || ARCH_ARMV8R) && ARCH_DPFPU
	select LIBM_ARCH_FMAX if (ARCH_ARMV8M || ARCH_ARMV8R) && ARCH_DPFPU
	depends on ARCH_FPU
	depends on LIBM
	---help---
		Enable ARM specific floating point optimizations.

endif
```

## net/icmp/Kconfig
```kconfig
#
# For a description of the syntax of this configuration file,
# see the file kconfig-language.txt in the NuttX tools repository.
#

menu "ICMP Networking Support"

config NET_ICMP
	bool "Enable ICMP networking"
	default NET_IPv4
	depends on NET_IPv4 || NET_ICMP_NO_STACK
	---help---
		Enable minimal ICMP support. Includes built-in support
		for sending replies to received ECHO (ping) requests.

		The in-kernel ICMP stack needs the in-kernel IPv4 stack, hence the
		dependency on NET_IPv4.  It does not apply when the stack is not
		built at all (NET_ICMP_NO_STACK), which is how ICMP sockets are
		offloaded to a user-space daemon over usrsock.

config NET_ICMP_NO_STACK
	bool "Disable ICMP stack"
	default n
	select NET_ICMP
	---help---
		Build without ICMP stack even if ICMP networking support enabled.

if NET_ICMP && !NET_ICMP_NO_STACK

config NET_ICMP_ECHO_BROADCASTS
	bool "Respond to broadcast/multicast ICMP echo requests"
	default n
	---help---
		If set, the system will respond to ICMP echo requests (pings) sent
		to broadcast or multicast addresses, including any multicast group
		the interface has joined and the subnet broadcast address.

		If not set (default), ICMP echo requests addressed to broadcast or
		multicast destinations will be silently dropped. This matches Linux's
		net.ipv4.icmp_echo_ignore_broadcasts=1 default behavior.

config NET_ICMP_PMTU_ENTRIES
	int "Path MTU Discovery (PMTUD) ICMP pmtu entry number"
	default 0
	---help---
		The number of the ICMP pmtu entry

config NET_ICMP_PMTU_TIMEOUT
	int "Path MTU Discovery (PMTUD) ICMP pmtu entry timeout (Time Unit:minute)"
	default 10
	depends on NET_ICMP_PMTU_ENTRIES != 0
	---help---
		The timout of the ICMP pmtu entry

config NET_ICMP_SOCKET
	bool "IPPROTO_ICMP socket support"
	default n
	select NET_READAHEAD
	---help---
		Enable support for IPPROTO_ICMP sockets.  These sockets are needed
		for application level support for sending ECHO (ping) requests and
		receiving associated ECHO replies.

config NET_ICMP_CHECKSUMS
	bool "ICMP checksums"
	default y
	---help---
		Enable/disable ICMP checksum support.

if NET_ICMP_SOCKET

config NET_ICMP_PREALLOC_CONNS
	int "Preallocated ICMP packet sockets"
	default 4
	---help---
		Number of ICMP connections (all tasks).

		This number of connections will be pre-allocated during system boot.
		If dynamic connections allocation is enabled, more connections may
		be allocated at a later time, as the system needs them. Else this
		will be the maximum number of connections available to the system
		at all times.

		Set to 0 to disable (and rely only on dynamic allocations).

config NET_ICMP_ALLOC_CONNS
	int "Dynamic ICMP connections allocation"
	default 0
	---help---
		Dynamic memory allocations for ICMP.

		When set to 0 all dynamic allocations are disabled.

		When set to 1 a new connection will be allocated every time,
		and it will be free'd when no longer needed.

		Setting this to 2 or more will allocate the connections in
		batches (with batch size equal to this config). When a
		connection is no longer needed, it will be returned to the
		free connections pool, and it will never be deallocated!

config NET_ICMP_MAX_CONNS
	int "Maximum number of ICMP connections"
	default 0
	depends on NET_ICMP_ALLOC_CONNS > 0
	---help---
		If dynamic connections allocation is selected (NET_ICMP_ALLOC_CONNS > 0)
		this will limit the number of connections that can be allocated.

		This is useful in case the system is under very heavy load (or
		under attack), ensuring that the heap will not be exhausted.

config NET_ICMP_NPOLLWAITERS
	int "Number of ICMP poll waiters"
	default 1

endif # NET_ICMP_SOCKET
endif # NET_ICMP && !NET_ICMP_NO_STACK
endmenu # ICMP Networking Support
```

## net/local/Kconfig
```kconfig
#
# For a description of the syntax of this configuration file,
# see the file kconfig-language.txt in the NuttX tools repository.
#

menu "Unix Domain Socket Support"
	depends on NET && !DISABLE_PSEUDOFS_OPERATIONS

config NET_LOCAL
	bool "Unix domain (local) sockets"
	default n
	select PIPES
	---help---
		Enable or disable Unix domain (aka Local) sockets.

if NET_LOCAL

config NET_LOCAL_VFS_PATH
	string "Path prefix to Unix domain sockets"
	default "/var/run"
	---help---
		The path prefix to where Unix domain sockets will exist in the VFS namespace.

config NET_LOCAL_PREALLOC_CONNS
	int "Preallocated local socket connections"
	default 8
	---help---
		Number of local socket connections (all tasks).

		This number of connections will be pre-allocated during system boot.
		If dynamic connections allocation is enabled, more connections may
		be allocated at a later time, as the system needs them. Else this
		will be the maximum number of connections available to the system
		at all times.

		Set to 0 to disable (and rely only on dynamic allocations).

config NET_LOCAL_ALLOC_CONNS
	int "Dynamic local socket connections allocation"
	default 1
	---help---
		Dynamic memory allocations for local sockets.

		When set to 0 all dynamic allocations are disabled.

		When set to 1 a new connection will be allocated every time,
		and it will be free'd when no longer needed.

		Setting this to 2 or more will allocate the connections in
		batches (with batch size equal to this config). When a
		connection is no longer needed, it will be returned to the
		free connections pool, and it will never be deallocated!

config NET_LOCAL_MAX_CONNS
	int "Maximum number of local socket connections"
	default 0
	depends on NET_LOCAL_ALLOC_CONNS > 0
	---help---
		If dynamic connections allocation is selected
		(NET_LOCAL_ALLOC_CONNS > 0), this will limit the number of
		connections that can be allocated.

		This is useful in case the system is under very heavy load (or
		under attack), ensuring that the heap will not be exhausted.

config NET_LOCAL_STREAM
	bool "Unix domain stream sockets"
	default y
	---help---
		Enable support for Unix domain SOCK_STREAM type sockets

config NET_LOCAL_DGRAM
	bool "Unix domain datagram sockets"
	default y
	---help---
		Enable support for Unix domain SOCK_DGRAM type sockets

config NET_LOCAL_SCM
	bool "Unix domain socket control message"
	default n
	---help---
		Enable support for Unix domain socket control message

endif # NET_LOCAL

endmenu # Unix Domain Sockets
```

## net/neighbor/Kconfig
```kconfig
#
# For a description of the syntax of this configuration file,
# see the file kconfig-language.txt in the NuttX tools repository.
#

if NET_IPv6

config NET_IPv6_NCONF_ENTRIES
	int "Number of IPv6 neighbors"
	default 8

config NET_ICMPv6_NEIGHBOR
	bool "Solicit destination addresses"
	default n
	depends on NET_ICMPv6 && !NET_ICMPv6_NO_STACK
	---help---
		Enable logic to send ICMPv6 neighbor solicitation requests if
		the target IPv6 address mapping does not appear in the Neighbor
		table.

if NET_ICMPv6_NEIGHBOR

config ICMPv6_NEIGHBOR_MAXTRIES
	int "ICMPv6 neighbor solicitation retries"
	default 5
	---help---
		Send the Neighbor solicitation this number of times before giving
		up and deciding that the target IP6 address is non reachable.

config ICMPv6_NEIGHBOR_DELAYMSEC
	int "ICMPv6 neighbor re-solicit delay"
	default 20
	---help---
		Wait this number of milliseconds after sending the Neighbor
		Solicitation before checking if the IPv6 address mapping is present
		in the Neighbor Table.  This time should be related to the maximum
		round trip time on the network since it is basically the time from
		when an Neighbor Solicitation is sent until the Neighbor
		Advertisement is received.

endif # NET_ICMPv6_NEIGHBOR

endif # NET_IPv6
```
