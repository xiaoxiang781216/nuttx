## drivers/tee/Kconfig
```kconfig
#
# For a description of the syntax of this configuration file,
# see the file kconfig-language.txt in the NuttX tools repository.
#

choice
	prompt "Select OP-TEE dev implementation"
	default DEV_OPTEE_NONE
	---help---
		There are three implementations of optee server,
		one is soft tee server which does not distinguish
		between secure and non-secure states and uses socket communication,
		and the other two is teeos which runs in the secure state of
		the cpu and uses either RPMsg cross-core communication or arm SMCs.
		Warning: SMC implementation has only been tested on arm64.

		DEV_OPTEE_DUMMY is not one of them: select it on the side that
		runs the server itself, which needs no client of its own.

config DEV_OPTEE_LOCAL
	bool "OPTEE Local Socket Support"
	depends on NET_LOCAL
	depends on FS_ANONMAP
	depends on ALLOW_BSD_COMPONENTS

config DEV_OPTEE_RPMSG
	bool "OP-TEE RPMSG Socket Support"
	depends on NET_RPMSG
	depends on FS_ANONMAP
	depends on ALLOW_BSD_COMPONENTS

config DEV_OPTEE_SMC
	bool "OP-TEE SMC CC Support"
	depends on ARCH_ARM || ARCH_ARM64
	depends on FS_ANONMAP
	depends on ALLOW_BSD_COMPONENTS

config DEV_OPTEE_DUMMY
	bool "OP-TEE RPMSG channel announcement"
	depends on RPMSG
	---help---
		Select this on the side that runs the OP-TEE server, rather than
		on a client of /dev/tee0.

		A TEE that shares memory with a REE over rpmsg has to make itself
		visible to that REE first: the REE binds its TEE backend to a named
		rpmsg channel, and binding is what hands that backend the rpmsg
		device it allocates the shared memory from.

		The channel carries no traffic of its own, as the requests
		themselves travel over the OP-TEE service socket, so the endpoint
		this creates is a sink.

config DEV_OPTEE_NONE
	bool "Disable OP-TEE driver"

endchoice

config DEV_OPTEE_CONNECT_TIMEOUT
	int "OP-TEE socket connect timeout in seconds"
	default 1
	depends on DEV_OPTEE_LOCAL || DEV_OPTEE_RPMSG
	---help---
		Timeout in seconds for the socket connect to the OP-TEE server.
		When the OP-TEE server is not available, connect() will block
		for up to this many seconds before returning an error. A shorter
		timeout improves responsiveness when TEE is unavailable.
		Set to 0 to use the system default timeout.

config DEV_OPTEE_CALL_TIMEOUT
	int "OP-TEE socket call (recv) timeout in seconds"
	default 30
	depends on DEV_OPTEE_LOCAL || DEV_OPTEE_RPMSG
	---help---
		Timeout in seconds for receiving the OP-TEE server response on
		the transport socket after a successful connect. Without this
		bound, optee_transport_call() can block indefinitely when the
		rpmsg/socket endpoint accepts the connection but the OP-TEE
		daemon (e.g., opteed) is not running, has crashed, or fails to
		respond. The default is generous enough to accommodate slow
		TEE crypto operations while still preventing test/host hangs
		when TEE becomes unresponsive. Set to 0 to use the system
		default (no bound).

config DEV_OPTEE_SUPPLICANT
	bool "Enables kernel driver for TEE supplicant"
	default n
	depends on DEV_OPTEE_SMC

config OPTEE_REMOTE_CPU_NAME
	string "The cpuname on which the OP-TEE server runs"
	default "tee"
	depends on DEV_OPTEE_RPMSG

if DEV_OPTEE_SMC

choice
	prompt "Select OP-TEE conduit method"
	default DEV_OPTEE_SMC_CONDUIT_SMC
	---help---
		Select between the 2 supported conduit methods for invoking the secure
		world: SMC (when running at EL1) and HVC (when running at EL2, which is
		not supported by NuttX yet).

config DEV_OPTEE_SMC_CONDUIT_SMC
	bool "Use SMC calls to invoke OP-TEE"

config DEV_OPTEE_SMC_CONDUIT_HVC
	bool "Use HVC calls to invoke OP-TEE"

endchoice

endif # DEV_OPTEE_SMC
```

## drivers/vhost/Kconfig
```kconfig
#
# For a description of the syntax of this configuration file,
# see the file kconfig-language.txt in the NuttX tools repository.
#

config DRIVERS_VHOST
	bool
	select OPENAMP
	select SCHED_WORKQUEUE
	default n

config DRIVERS_VHOST_BLK
	bool "Virtual Host Blk Device Support"
	default n
	select DRIVERS_VHOST

if DRIVERS_VHOST_BLK

config DRIVERS_VHOST_BLK_PRIORITY
	int "vhost blk thread priority"
	default 224

config DRIVERS_VHOST_BLK_STACKSIZE
	int "vhost blk stack size"
	default 4096

endif # DRIVERS_VHOST_BLK

config DRIVERS_VHOST_CAN
	bool "Virtual Host CAN Device Support"
	depends on NET_CAN
	default n
	select DRIVERS_VHOST
	select NET_CAN_HAVE_CANFD
	---help---
		Enable the vhost CAN backend.  It bridges a VirtIO CAN device
		(device ID 36) to a local SocketCAN interface, forwarding frames
		between the guest tx/rx/control virtqueues and the local bus.

config DRIVERS_VHOST_NET
	bool "Virtual Host Net Device Support"
	depends on NETDEVICES
	default n
	select ARCH_HAVE_NETDEV_STATISTICS
	select NETDEV_LATEINIT
	select DRIVERS_VHOST

config DRIVERS_VHOST_I2C
	bool "Virtual Host I2C Device Support"
	default n
	select I2C
	select DRIVERS_VHOST
	---help---
		Enable the vhost (device-side) I2C backend.  When an rptun resource
		table exposes a VirtIO I2C adapter device (device ID 34) in the
		device role, this driver serves the request virtqueue, decodes each
		request with the OASIS VirtIO I2C wire format, and forwards it to a
		local I2C lower-half registered with vhost_i2c_register().  This lets
		one NuttX instance export an I2C bus to a remote VirtIO I2C frontend,
		the native-VirtIO counterpart of the RPMSG I2C server.

config DRIVERS_VHOST_SPI
	bool "Virtual Host SPI Device Support"
	depends on SPI && SPI_EXCHANGE
	default n
	select DRIVERS_VHOST
	---help---
		Enable the vhost (device-side) SPI backend.  When an rptun resource
		table exposes a VirtIO SPI device (device ID 45) in the device role,
		this driver serves the request virtqueue, decodes each transfer with
		the Linux-compatible VirtIO SPI wire format, and drives a local SPI
		lower-half registered with vhost_spi_register().

config DRIVERS_VHOST_PING
	bool "Virtual Host Ping Device Support"
	default n
	select DRIVERS_VHOST
	---help---
		Enable the vhost (device-side) ping backend.  When an rptun resource
		table exposes a VirtIO ping device (vendor-local device ID 63) in the
		device role, this driver serves the request virtqueue by echoing each
		request's sequence number back through the writable segment of the
		same descriptor chain, optionally verifying the payload.  It is the
		peer of DRIVERS_VIRTIO_PING and is diagnostic-only.

config DRIVERS_VHOST_RNG
	bool "Virtual Host Rng Device Support"
	default n
	select DRIVERS_VHOST

config DRIVERS_VHOST_RPMSG
	bool "Virtual Host Rpmsg Device Support"
	default n
	select RPMSG_VIRTIO
	select DRIVERS_VHOST

config DRIVERS_VHOST_SERIAL
	bool "Virtual Host Serial Device Support"
	default n

if DRIVERS_VHOST_SERIAL

config DRIVERS_VHOST_SERIAL_PRIORITY
	int "vhost serial thread priority"
	default 224

config DRIVERS_VHOST_SERIAL_STACKSIZE
	int "vhost serial stack size"
	default DEFAULT_TASK_STACKSIZE

endif

config DRIVERS_VHOST_RPMB
	bool "Virtual Host Rpmb Device Support"
	default n
	select DRIVERS_VHOST

if DRIVERS_VHOST_RPMB

config DRIVERS_VHOST_RPMB_PRIORITY
	int "vhost rpmb thread priority"
	default 224

config DRIVERS_VHOST_RPMB_STACKSIZE
	int "vhost rpmb stack size"
	default DEFAULT_TASK_STACKSIZE

endif
```

## fs/fatfs/Kconfig
```kconfig
#
# For a description of the syntax of this configuration file,
# see the file kconfig-language.txt in the NuttX tools repository.
#

menuconfig FS_FATFS
	bool "FATFS File System"
	default n
	depends on !DISABLE_MOUNTPOINT
	---help---
		Build the FATFS file system. http://elm-chan.org/fsw/ff/00index_e.html

config FS_FATFS_SECTOR_RATIO
	int "The ratio between fatfs filesystem sector and block device sector"
	depends on FS_FATFS
	default 1

config FS_FATFS_ERROR_LOG
	bool "FATFS file system output detail error log"
	depends on DEBUG_FS_ERROR
	---help---
		Enable FATFS file system detail error log.

config FS_FATFS_DEBUG
	bool "FATFS file system read/write double check"
	depends on DEBUG_FS_ERROR
	---help---
		Enable FATFS file system read/write double check.

config FS_FATFS_MAX_OPEN_FILES
	int "The maximum number of open files in fatfs filesystem"
	depends on FS_FATFS
	default 256

config FS_FATFS_RPATH
	int "FATFS relative path support level"
	depends on FS_FATFS
	default 2
	range 0 2
	---help---
		Configure relative path support in FatFs (FF_FS_RPATH):
		  0: Disable relative path. Path names starting from the root
		     directory only. Path segments "." and ".." are rejected
		     with FR_INVALID_NAME.
		  1: Enable relative path. f_chdir() and f_chdrive() available.
		  2: f_getcwd() available in addition to level 1.

		Level >= 1 is required to open files through path names that
		contain "." or ".." segments (e.g. "../data/file").
```

## fs/lwext4/Kconfig
```kconfig
#
# For a description of the syntax of this configuration file,
# see the file kconfig-language.txt in the NuttX tools repository.
#

menuconfig FS_LWEXT4
	bool "lwext4 File System"
	default n
	depends on !DISABLE_MOUNTPOINT
	---help---
		Build the lwext4 (ext2/3/4) file system support.
		This is a lightweight implementation of ext2/3/4 filesystem
		suitable for embedded systems.
		https://github.com/gkostka/lwext4

if FS_LWEXT4

config LWEXT4_BCACHE_BLOCKS
	int "Number of cached blocks"
	default 64
	---help---
		Number of blocks to cache. Each block size depends on the
		filesystem block size (typically 1KB or 4KB), so the cache
		memory upper bound is this count times the filesystem block
		size.

		This cache is only valid for metadata (inode, extent, directory,
		bitmap and superblock blocks). File data bypasses the cache and
		is read/written directly to the user buffer.

config LWEXT4_ENABLE_JOURNAL
	bool "Enable journaling support"
	default y
	---help---
		Enable journal (JBD2) for data consistency. Disabling this
		improves performance but may cause data loss on power failure.

config LWEXT4_MAX_MOUNTPOINTS
	int "Maximum number of mount points"
	default 4
	range 1 10
	---help---
		Maximum number of ext4 filesystems that can be mounted
		simultaneously.

endif # FS_LWEXT4
```

## fs/shm/Kconfig
```kconfig
#
# For a description of the syntax of this configuration file,
# see the file kconfig-language.txt in the NuttX tools repository.
#

config FS_SHMFS
	bool "Shared memory support"
	default n
	select ARCH_VMA_MAPPING if BUILD_KERNEL
	---help---
		Include support for shm_open() and shm_close.

if FS_SHMFS

config FS_SHMFS_VFS_PATH
	string "Path to shared memory object storage"
	default "/var/shm"
	---help---
		The path to where shared memory objects will exist in the VFS
		namespace.

config FS_SHMFS_NAME_INITIAL_SLASH
	bool "shm object name (starts with '/')"
	default n
	---help---
		POSIX.1-2001 require that shm object names must start with a '/'
		character. When enabled, creating/opening a shared memory object
		with a name not starting with '/' will return an error.
		POSIX.1-2008 makes non-slash names implementation-defined.
		Disabled by default to maintain backward compatibility.

endif # FS_SHMFS
```

## fs/yaffs/Kconfig
```kconfig
#
# For a description of the syntax of this configuration file,
# see the file kconfig-language.txt in the NuttX tools repository.
#

config FS_YAFFS
	bool "YAFFS File System"
	default n
	depends on !DISABLE_MOUNTPOINT && MTD
	select FTL_BBM
	---help---
		Build the YAFFS file system. https://yaffs.net/documents/yaffs-direct-interface

if FS_YAFFS
config FS_YAFFS_RESERVED_BLOCKS
	int "YAFFS Reserved blocks"
	default 5
	---help---
		Number of good blocks blocks reserved for garbage collection etc.
		Needs to be at least 2, but 5 would be a more typical number.

config FS_YAFFS_CHUNK_CACHE
	int "YAFFS Chunk cache is used for short read/write operations"
	default 20
	---help---
		Number of chunks to store in the short operation cache.
		Zero disables caching. Typical value is 10 to 20 or so.
		Caching is required for inband tags.

config FS_YAFFS_REFRESH_PERIOD
	int "How often Yaffs should do a block refresh"
	default 1000
	---help---
		Values less than 10 disable block refreshing.

config FS_YAFFS_CACHE_BYPASS_ALIGNED
	bool "YAFFS Bypass the cache for aligned writes"
	default n
	---help---
		Flag to by pass the cache for aligned writes.

config FS_YAFFS_SKIP_READ_CHECKPOINT
	bool "YAFFS Skip reading checkpoint"
	default n
	---help---
		Flag to skip reading checkpoint on mount.
		If set then a re-scan is forced.

config FS_YAFFS_SKIP_WRITE_CHECKPOINT
	bool "YAFFS Skip writing checkpoint"
	default n
	---help---
		Flag to skip writing checkpoint on sync or unmount.

config FS_YAFFS_EMPTY_LOST_FOUND
	bool "YAFFS Auto-empty lost+found directory"
	default n
	---help---
		Flag to delete all files in lost and found on mount.

config FS_YAFFS_DEBUG
	bool "YAFFS file system read/write double check"
	depends on DEBUG_FS_ERROR
	---help---
		Enable YAFFS file system read/write double check.

config FS_YAFFS_POSIX_TIMESTAMP
	bool "YAFFS POSIX atime/mtime/ctime updates"
	default n
	---help---
		Update access/modification/change times on read, write, open,
		close and readdir for POSIX conformance. Adds a per-operation
		flush (flash-wear cost) and PATH_MAX storage per open directory;
		intended for conformance testing, not production use.

config FS_YAFFS_N_HANDLES
	int "YAFFS max open file handles (system-wide)"
	default LIBC_OPEN_MAX
	---help---
		Size of the YAFFS per-device handle/inode/file-descriptor
		pool, i.e. the system-wide cap on concurrently open YAFFS
		files.  Must be at least CONFIG_LIBC_OPEN_MAX (OPEN_MAX) so
		that the per-process file-descriptor limit (EMFILE) is the
		binding constraint when a process exhausts its fd table;
		otherwise YAFFS returns ENFILE first, failing POSIX cases
		that expect EMFILE (e.g. PSE52 VSX fopen).
endif
```
