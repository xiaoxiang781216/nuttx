## drivers/rpmsg/Kconfig
```kconfig
#
# For a description of the syntax of this configuration file,
# see the file kconfig-language.txt in the NuttX tools repository.
#

config RPMSG
	bool
	default n
	select OPENAMP
	select SCHED_WORKQUEUE

if RPMSG

config RPMSG_CHAR
	bool "rpmsg char support"
	default n
	---help---
		User can use the /dev/rpmsg/<cpuname> to create the
		endpoint and then use /dev/rpmsg-<name> to communicate with
		remote processer.

config RPMSG_CHAR_NPOLLWAITERS
	int "rpmsg char number of the poll waiters"
	default 2
	depends on RPMSG_CHAR

config RPMSG_WQUEUE_GLOBAL
	bool "rpmsg global work queue"
	default n
	---help---
		This is for rpmsg global work queue.

config RPMSG_WQUEUE_PRIORITY
	int "rpmsg work queue priority"
	default 224

config RPMSG_WQUEUE_STACKSIZE
	int "rpmsg work queue stack size"
	default 4096

config RPMSG_WQUEUE_NUMBER
	int "rpmsg work queue number"
	default 1
	range 1 256
	---help---
		This macro sets the number of rpmsg work queue. It can be
		customized and the minimum value is 1.

config RPMSG_TRACE
	bool "rpmsg trace"
	default n
	depends on DRIVERS_NOTERAM
	---help---
		This is for trace and record all message passed through
		rpmsg channel, including the type,src,dst and recored the ept.

config RPMSG_TRACE_BUFSIZE
	int "rpmsg trace buffer size"
	default 16384
	depends on RPMSG_TRACE
	---help---
		This macro sets the trace buffer size corresponding to rpmsg.
		It can be customized and the dafault value is 16384.

config RPMSG_TRACE_BACKTRACE
	int "Rpmsg trace backtrace"
	depends on RPMSG_TRACE
	default 0
	range 0 16

config RPMSG_LOCAL_CPUNAME
	string "Rpmsg Local Cpuname"
	default LIBC_HOSTNAME

config RPMSG_PING
	bool "rpmsg ping support"
	default n
	---help---
		This is for debugging & profiling, create ping rpmsg
		channel, user can use it to get send/recv speed & latency.

config RPMSG_TEST
	bool "rpmsg test support"
	default n

config RPMSG_WAKELOCK
	bool "rpmsg wakelock support"
	default n
	depends on PM
	---help---
		rpmsg wakelock enable option, both for client and server.

config RPMSG_PROCFS
	bool "Include rpmsg info in procfs"
	depends on FS_PROCFS_REGISTER
	default !DEFAULT_SMALL
	---help---
		Use RPMSG file system to cat rpmsg info

config RPMSG_POOL_COUNT
	int "rpmsg pool buffer count"
	default 0
	---help---
		This macro sets the count of rpmsg pool buffers, each pool
		can be used to allocate rpmsg buffers. 0 means disable
		rpmsg pool.

config RPMSG_POOL_SIZE
	int "rpmsg pool size"
	depends on RPMSG_POOL_COUNT != 0
	default 64
	---help---
		This macro sets the size of each rpmsg pool, which is used
		to allocate rpmsg buffers. The default value is 64 bytes.

config RPMSG_PANIC_DUMP_VERBOSE
	bool "rpmsg panic dump verbose"
	default !DEFAULT_SMALL
	---help---
		Dump verbose info when rpmsg dump, default is y unless
		DEFAULT_SMALL is y.

endif # RPMSG

config RPMSG_ROUTER
	bool "rpmsg router support"
	default n
	select RPMSG
	---help---
		Rpmsg router driver for enabling communication
		without physical channels.

config RPMSG_PORT
	bool
	default n
	select RPMSG
	---help---
		Rpmsg port transport layer used for cross chip communication.

config RPMSG_PORT_SPI
	bool "Rpmsg SPI Port Driver Support"
	default n
	select RPMSG_PORT
	---help---
		Rpmsg SPI Port driver used for cross chip communication.

config RPMSG_PORT_SPI_SLAVE
	bool "Rpmsg SPI Slave Port Driver Support"
	default n
	select RPMSG_PORT
	---help---
		Rpmsg SPI Slave Port driver used for cross chip communication.

if RPMSG_PORT_SPI || RPMSG_PORT_SPI_SLAVE

config RPMSG_PORT_SPI_THREAD_PRIORITY
	int "Rpmsg SPI Port Thread Priority"
	default 224

config RPMSG_PORT_SPI_THREAD_STACKSIZE
	int "Rpmsg SPI Port Stack Size"
	default 4096

config RPMSG_PORT_SPI_CRC
	bool "Rpmsg SPI Port Use CRC Check"
	default n

config RPMSG_PORT_SPI_RX_THRESHOLD
	int "Rpmsg SPI Port Rx Buffer Threshold"
	default 50
	range 0 100

config RPMSG_PORT_SPI_PM_TIMEOUT
	int "Rpmsg SPI Port PM Stay Timeout in Milliseconds"
	default 1
	depends on PM

endif # RPMSG_PORT_SPI || RPMSG_PORT_SPI_SLAVE

config RPMSG_PORT_UART
	bool "Rpmsg Uart Port Driver Support"
	default n
	depends on SCHED_EVENTS
	select RPMSG_PORT
	---help---
		Rpmsg Uart Port driver used for cross chip communication.

if RPMSG_PORT_UART

config RPMSG_PORT_UART_RX_THREAD_PRIORITY
	int "Rpmsg UART Port RX Thread Priority"
	default 224

config RPMSG_PORT_UART_RX_THREAD_STACKSIZE
	int "Rpmsg UART Port RX Stack Size"
	default DEFAULT_TASK_STACKSIZE

config RPMSG_PORT_UART_TX_THREAD_PRIORITY
	int "Rpmsg UART Port TX Thread Priority"
	default 224

config RPMSG_PORT_UART_TX_THREAD_STACKSIZE
	int "Rpmsg UART Port TX Stack Size"
	default DEFAULT_TASK_STACKSIZE

config RPMSG_PORT_UART_CRC
	bool "Rpmsg UART Port CRC Enable"
	default n

config RPMSG_PORT_UART_DEBUG
	bool "Rpmsg UART DEBUG Enable"
	default n

endif # RPMSG_PORT_UART

config RPMSG_VIRTIO
	bool
	default n
	select RPMSG
	---help---
		The Rpmsg VirtIO Lite, VirtIO-Rpmsg and VHost-Rpmsg common
		part.

if RPMSG_VIRTIO

config RPMSG_VIRTIO_PM
	bool "rpmsg virtio power management"
	depends on PM
	default n
	---help---
		If TX/RX buffer is supplied and powered by each CPU.
		And when one CPU in DEEP sleep, then it's buffer will
		goto RAM-retention mode, can't access from another CPU.
		So, we provide this method to resolve this.

config RPMSG_VIRTIO_PM_AUTORELAX
	bool "rpmsg virtio pm autorelax"
	depends on RPMSG_VIRTIO_PM
	default y
	---help---
		use wd_timer to auto relax pm

endif # RPMSG_VIRTIO
```

## drivers/trace32/Kconfig
```kconfig
#
# For a description of the syntax of this configuration file,
# see the file kconfig-language.txt in the NuttX tools repository.
#

menu "Trace32 drivers"

config TRACE32_FDX
	bool
	default n
	---help---
		The Trace32 FDX driver.

config TRACE32_TERM
	bool
	default n
	---help---
		The Trace32 term driver.

config TRACE32_TERM_MEMORY_BLOCKED_SIZE
	hex "Trace32 Term up/down buffer size"
	depends on TRACE32_TERM
	range 0x100 0x3C00
	default 0x1000
	---help---
		The buffer block size for trace32 term up and down is used for
		the buffer size of the serial's own trace (tx) and trace (rx),
		and also for the size in the trace term protocol.

config DRIVERS_NOTET32FDX
	bool "Trace32 FDX Note driver"
	select DRIVERS_NOTE
	select TRACE32_FDX
	default n
	---help---
		The Note driver output to trace32 FDX.

if DRIVERS_NOTET32FDX

config DRIVERS_NOTET32FDX_FILTER_DEFAULT_MODE
	hex "Trace32 FDX Note driver filter mode"
	depends on SCHED_INSTRUMENTATION_FILTER
	default SCHED_INSTRUMENTATION_FILTER_DEFAULT_MODE
	---help---
		Filter mode for notefdx

config DRIVERS_NOTET32FDX_BUFSIZE
	int "Trace32 FDX Note driver buffer size"
	default 1024
	---help---
		The size of the FDX buffer (in bytes).

config DRIVERS_NOTET32FDX_CPUSET
	hex "Trace32 FDX Note driver CPU set"
	depends on SMP && SCHED_INSTRUMENTATION_FILTER
	default SCHED_INSTRUMENTATION_CPUSET
	---help---
		CPU set for notefdx

config DRIVERS_NOTET32FDX_SECTION
	string "Trace32 FDX Note driver section"
	default ""
	---help---
		The section in which to place the notefdx buffer.

endif # DRIVERS_NOTET32FDX

config STREAM_FDX
	bool "Stream to/from Trace32 FDX"
	select TRACE32_FDX
	default n
	---help---
		Use Segger Trace32 FDX as a stream output.

config SYSLOG_FDX
	bool "Log to Trace32 FDX"
	select TRACE32_FDX
	default n
	---help---
		Use Trace32 FDX as a SYSLOG output device.

config SYSLOG_FDX_BUFSIZE
	int "Trace32 FDX syslog driver buffer size"
	depends on SYSLOG_FDX
	default 1024
	---help---
		The size of the FDX syslog buffer (in bytes).

config SERIAL_T32TERM
	bool "Serial Device Trace32 Term"
	select TRACE32_TERM
	default n
	---help---
		Trace32 term protocol serial port

if SERIAL_T32TERM

config SERIAL_T32TERM_CONSOLE
	bool "Serial Device Trace32 Term Console"
	default n
	---help---
		Terminal based on the trace32 term protocol serial port

config SERIAL_T32TERM_POLLING_INTERVAL
	int "Trace32 Term serial pilling interval (us)"
	default USEC_PER_TICK
	---help---
		This option is used to configure the Trace32 term serial polling interval

endif # SERIAL_T32TERM

endmenu # Trace32 drivers
```

## fs/archivefs/Kconfig
```kconfig
#
# For a description of the syntax of this configuration file,
# see the file kconfig-language.txt in the NuttX tools repository.
#

config FS_ARCHIVEFS
	bool "ARCHIVE File System"
	default n

if FS_ARCHIVEFS

config FS_ARCHIVEFS_BUFFER_SIZE
	int "Buffer size"
	default 32768
	---help---
		libarchive requires a buffer to read and write data.

endif
```

## fs/lrofs/Kconfig
```kconfig
#
# For a description of the syntax of this configuration file,
# see the file kconfig-language.txt in the NuttX tools repository.
#

config FS_LROFS
	bool "LROFS file system"
	default n
	depends on !DISABLE_MOUNTPOINT
	---help---
		Enable LROFS filesystem support
if FS_LROFS

config FS_LROFS_CACHE_FILE_NSECTORS
	int "The number of file cache sector"
	range 1 256
	default 1
	---help---
		The number of file cache sector

endif
```

## fs/mqueue/Kconfig
```kconfig
#
# For a description of the syntax of this configuration file,
# see the file kconfig-language.txt in the NuttX tools repository.
#

if !DISABLE_MQUEUE

config FS_MQUEUE_VFS_PATH
	string "Path to message queue"
	default "/var/mqueue"
	---help---
		The path to where POSIX message queues will exist in the VFS namespace.

config FS_MQUEUE_NPOLLWAITERS
	int "Maximum number of poll waiters"
	default 4
	---help---
		The maximum number of waiters for the poll operation.

config FS_MQUEUE_NAME_INITIAL_SLASH
	bool "Message queue name starts with '/'"
	default n
	---help---
		Require that message queue names (mq_name) must start with a '/' character.
		When enabled, creating/opening a message queue with a name not starting
		with '/' will return an error.
		Disabled by default to maintain backward compatibility.

endif # !DISABLE_MQUEUE
```

## fs/notify/Kconfig
```kconfig
#
# For a description of the syntax of this configuration file,
# see the file kconfig-language.txt in the NuttX tools repository.
#

config FS_NOTIFY
	bool "FS Notify System"
	default n
	---help---
		The Fsnotify System

if FS_NOTIFY
config FS_NOTIFY_BUCKET_SIZE
	int "Dir hash bucket size"
	default 64

config FS_NOTIFY_MAX_EVENTS
	int "Max events in one notify device"
	default 1024

config FS_NOTIFY_FD_POLLWAITERS
	int "Max pollwaiters in one notify devcie"
	default 2

config FS_NOTIFY_OPEN_MONITOR
	bool "Enable notify_open"
	default n

config FS_NOTIFY_CLOSE_MONITOR
	bool "Enable notify_close"
	default n

config FS_NOTIFY_WRITE_MONITOR
	bool "Enable notify_write"
	default n

config FS_NOTIFY_READ_MONITOR
	bool "Enable notify_read"
	default n

endif # FS_NOTIFY
```

## fs/semaphore/Kconfig
```kconfig
#
# For a description of the syntax of this configuration file,
# see the file kconfig-language.txt in the NuttX tools repository.
#

config FS_NAMED_SEMAPHORES
	bool "Named semaphore support"
	default n
	---help---
		Include support for named semaphores.

if FS_NAMED_SEMAPHORES

config FS_NAMED_SEMAPHORES_VFS_PATH
	string "Path to semaphore storage"
	default "/var/sem"
	---help---
		The path to where named semaphores will exist in the VFS namespace.

config FS_NAMED_SEMAPHORES_INITIAL_SLASH
	bool "semaphore name (starts with '/')"
	default n
	---help---
		Require that semaphore names (sem_name) must start with a '/' character.
		When enabled, creating/opening a semaphore with a name not starting
		with '/' will return an error.
		Disabled by default to maintain backward compatibility.

endif # FS_NAMED_SEMAPHORES
```

## fs/vfs/Kconfig
```kconfig
#
# For a description of the syntax of this configuration file,
# see the file kconfig-language.txt in the NuttX tools repository.
#

config EVENT_FD
	bool "EventFD"
	default n
	---help---
		Create a file descriptor for event notification

if EVENT_FD

config EVENT_FD_POLL
	bool "EventFD poll support"
	default y
	---help---
		Poll support for file descriptor based events

config EVENT_FD_NPOLLWAITERS
	int "Number of eventFD poll waiters"
	default 2
	depends on EVENT_FD_POLL
	---help---
		Maximum number of threads that can be waiting on poll()

endif # EVENT_FD

config TIMER_FD
	bool "TimerFD"
	default n
	---help---
		Create a file descriptor for timer notification

if TIMER_FD

config TIMER_FD_POLL
	bool "TimerFD poll support"
	default y
	---help---
		Poll support for file descriptor based timers

config TIMER_FD_NPOLLWAITERS
	int "Number of timerFD poll waiters"
	default 2
	depends on TIMER_FD_POLL
	---help---
		Maximum number of threads that can be waiting on poll()

endif # TIMER_FD

config SIGNAL_FD
	bool "SignalFD"
	depends on !DISABLE_SIGNALS
	default n
	---help---
		Create a file descriptor for accepting signals

if SIGNAL_FD

config SIGNAL_FD_NPOLLWAITERS
	int "Number of signalFD poll waiters"
	default 2
	---help---
		Maximum number of threads that can be waiting on poll()

endif # SIGNAL_FD

config FS_NOTIFY
	bool "FS Notify System"
	default n
	---help---
		The Fsnotify System

if FS_NOTIFY
config FS_NOTIFY_BUCKET_SIZE
	int "Dir hash bucket size"
	default 64

config FS_NOTIFY_MAX_EVENTS
	int "Max events in one notify device"
	default 1024

config FS_NOTIFY_FD_POLLWAITERS
	int "Max pollwaiters in one notify device"
	default 2

endif # FS_NOTIFY

config FS_BACKTRACE
	bool "VFS backtrace"
	default n
	depends on LIBC_BACKTRACE_DEPTH > 0
	---help---
		Add backtrace to vfs file open.

config FS_BACKTRACE_SKIP
	int "Backtrace to skip"
	default 4
	depends on FS_BACKTRACE
	---help---
		Skip depth of backtrace.

config FS_PATHCACHE
	bool "Pathcache of struct file"
	default n
	depends on !DISABLE_MOUNTPOINT
	---help---
		Enable caching of struct file to accelerate file open operations.
		When a file is opened, its metadata (stored in struct file) is
		cached and reused on subsequent opens, avoiding the overhead of
		repeated filesystem-specific open operations.

if FS_PATHCACHE

config FS_PATHCACHE_MAX_ENTRIES
	int "Maximum number of cached files"
	default 64
	---help---
		The maximum number of file entries that can be cached. When this
		limit is reached, the least recently used (LRU) entry will be
		evicted to make room for new entries.

config FS_PATHCACHE_HASH_SIZE
	int "Pathcache hash table size"
	default 32
	---help---
		The size of the hash table used for the pathcache. The value
		should be a power of 2 for optimal hash distribution.

endif # FS_PATHCACHE
```
