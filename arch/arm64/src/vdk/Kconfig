## arch/arm64/src/vdk/Kconfig
```kconfig
#
# For a description of the syntax of this configuration file,
# see the file kconfig-language.txt in the NuttX tools repository.
#

if ARCH_CHIP_VDK

menu "VDK Virt Chip Selection"

choice
	prompt "VDK Core Configuration"
	default ARCH_CHIP_VDK_R82

config ARCH_CHIP_VDK_R82
	bool "VDK virtual Processor (cortex-r82)"
	select ARCH_HAVE_MULTICPU
	select ARCH_SET_VMPIDR_EL2

endchoice # VDK Chip Selection

endmenu # "VDK Chip Selection"

endif # ARCH_CHIP_VDK
```

## arch/tricore/src/tc3xx/Kconfig
```kconfig
#
# For a description of the syntax of this configuration file,
# see the file kconfig-language.txt in the NuttX tools repository.
#

config ARCH_CHIP_TC397
	bool "AURIX Family TC397"
	---help---
		AURIX TC39x family: TC397

comment "TC3XX Configuration Options"

menu "TC3XX Peripheral Support"

# These are the peripheral selections proper

config TC3XX_UART0
	bool "TC3XX UART0"
	default y
	select UART0_SERIALDRIVER
	select ARCH_HAVE_SERIAL_TERMIOS

endmenu
```

## devicetree/Kconfig
```kconfig
#
# For a description of the syntax of this configuration file,
# see the file kconfig-language.txt in the NuttX tools repository.
#

config DEVICETREE_HEADER_GENERATION
	bool "Device Tree header file generation support"
	default n
	---help---
		This option enables support for generate device tree
		header file in NuttX.

		NOTE: The config directories following can be either relative
		to the project or an absolute path, which was separated by comma.

if DEVICETREE_HEADER_GENERATION

config DTS_SOURCE_DTR
	string "Device Tree source file directories"
	default ""
	---help---
		This option specifies the source file directories to be
		compiled into the device tree binary.

config DTS_OVERLAY_DIR
	string "Device Tree overlay file directories"
	default ""
	---help---
		This option specifies the overlay file directories to be
		compiled into the device tree binary.

config DTS_CUSTOM_BINDINGS_DIR
	string "Device Tree custom bindings directory"
	default ""
	---help---
		This option specifies the directory containing the
		custom device tree bindings.

config DTS_CUSTOM_DT_BINDINGS_INCLUDE_DIR
	string "Device Tree custom dt-bindings directory"
	default ""
	---help---
		This option specifies the directory containing the
		custom device tree header files.

endif # if DEVICETREE_HEADER_GENERATION
```

## drivers/aie/Kconfig
```kconfig
#
# For a description of the syntax of this configuration file,
# see the file kconfig-language.txt in the NuttX tools repository.
#

menuconfig AI_ENGINE
	bool "AI Engine Acceleration Support"
	default n
	---help---
		Drivers for various AI engine devices.

if AI_ENGINE

source "drivers/aie/ethosu/Kconfig"

endif # AI_ENGINE
```

## drivers/aie/ethosu/Kconfig
```kconfig
#
# For a description of the syntax of this configuration file,
# see the file kconfig-language.txt in the NuttX tools repository.
#

menuconfig ETHOSU
	bool "Arm Ethos-U NPU support"
	default n
	depends on ARCH_ARM && CMSIS
	---help---
		Enable support for Arm Ethos-U NPU (Neural Processing Unit).
		This driver provides AI Engine lower half implementation for neural network inference.

if ETHOSU

choice ETHOSU_ARCH
	prompt "Ethos-U Architecture"
	default ETHOSU_U55
	---help---
		Select the target Ethos-U NPU architecture variant.

config ETHOSU_U55
	bool "Ethos-U55"
	---help---
		Select Ethos-U55 NPU architecture.

config ETHOSU_U65
	bool "Ethos-U65"
	---help---
		Select Ethos-U65 NPU architecture.

config ETHOSU_U85
	bool "Ethos-U85"
	---help---
		Select Ethos-U85 NPU architecture.

endchoice

endif # ETHOSU
```

## drivers/binder/Kconfig
```kconfig
#
# For a description of the syntax of this configuration file,
# see the file kconfig-language.txt in the NuttX tools repository.
#

comment "Binder Driver for NuttX"

config DRIVERS_BINDER
	bool "Binder IPC Driver"
	default n
	---help---
		Binder is used for both communication between processes,
		and remote method invocation.
		This means one process can call a method/routine in another
		process, using Binder to identify, invoke and pass arguments
		between said processes.

config DRIVERS_BINDER_DEBUG
	bool "Binder IPC Driver Debug Message Out Enable"
	default n
	depends on DRIVERS_BINDER
	---help---
		This option enable binder debug message output.

config DRIVERS_BINDER_MAX_VMSIZE
	int "Drivers binder max vmsize"
	default 16384
	depends on DRIVERS_BINDER

config DRIVERS_BINDER_MAX_THREADS
	int "Drivers binder max thread"
	default 4
	depends on DRIVERS_BINDER

config DRIVERS_BINDER_NPOLLWAITERS
	int "Driver binder number of poll waiters"
	default 4
	depends on DRIVERS_BINDER
```

## drivers/cpufreq/Kconfig
```kconfig
#
# For a description of the syntax of this configuration file,
# see the file kconfig-language.txt in the NuttX tools repository.
#

config CPUFREQ
	bool "cpufreq"
	default n
	---help---
		CPUFREQ

if CPUFREQ

config CPUFREQ_PROCFS
	bool "cpufreq_procfs"
	default n
	depends on FS_PROCFS
	---help---
		CPUFREQ_PROCFS

if CPUFREQ_PROCFS

config CPUFREQ_PROCFS_QOS
	bool "Print cpufreq QOS request"
	default n
	---help---
		Print cpufreq QOS request

endif

choice
	prompt "CPUFREQ_DEFAULT_GOVERNOR"
	default CPUFREQ_DEFAULT_GOV_PERFORMANCE

config CPUFREQ_DEFAULT_GOV_PERFORMANCE
	bool "cpufreq_performance"
	---help---
		cpufreq_performance governor

config CPUFREQ_DEFAULT_GOV_POWERSAVE
	bool "cpufreq_powersave"
	---help---
		cpufreq_powersave governor

config CPUFREQ_DEFAULT_GOV_ONDEMAND
	bool "cpufreq_ondemand"
	---help---
		cpufreq_ondemand governor

config CPUFREQ_DEFAULT_GOV_QLEARNING
	bool "cpufreq_qlearning"
	depends on !ARCH_PERF_EVENTS && PM
	---help---
		cpufreq_qlearning governor

endchoice

if CPUFREQ_DEFAULT_GOV_ONDEMAND

config CPUFREQ_SAMPLE_RATE
	int "the default sample rate (us) to get the cpuload"
	default 1000000
	---help---
		Ondemand sample rate

config CPUFREQ_LOAD_THRESHOLD
	int "the default cpu load threshold up to max cpu freq"
	default 80
	---help---
		Ondemand cpu load threshold

endif

if CPUFREQ_DEFAULT_GOV_QLEARNING

config CPUFREQ_QLEARNING_WAIT_TIME
	int "the default wait time (ms) between two samples"
	default 100
	---help---
		wait time between two samples

config CPUFREQ_QLEARNING_INIT_WAIT_TIME
	int "the default wait time (ms) for system boot"
	default PM_GOVERNOR_EXPLICIT_RELAX
	---help---
		wait for system boot, then read the initial parameters. Reading
		file will fail if system boot is not finished.

config CPUFREQ_QLEARNING_INIT_FREQ
	int "the default initial freq(KHz)"
	default 100000
	---help---
		initial freq of cpufreq qlearning governor, before reading the
		parameters from file finished.

config CPUFREQ_QLEARNING_FILE_PATH
	string "File path of cpufreq qlearning parameters"
	default "/etc/cpufreq_qlearning_params.bin"
	---help---
		File path of cpufreq qlearning parameters

config CPUFREQ_QLEARNING_MIN_FREQ
	int "the default min cpu freq(KHz)"
	default 32
	---help---
		min freq of cpufreq qlearning governor, if current freq is lower
		than this value, qlearning algorithm will not run. It is a workaround
		to avoid high overhead cause by running algorithm at low frequency.

config CPUFREQ_QLEARNING_NEURONS_PER_LAYER
	int "number of neurons in each Q-learning layer"
	default 10
	---help---
		Number of neurons (or units) in each fully-connected layer of the
		Q-learning neural network. This also determines the size of weight
		matrices and bias vectors.

config CPUFREQ_QLEARNING_NUM_LAYERS
	int "number of layers in the Q-learning neural network"
	default 3
	---help---
		Number of fully-connected layers in the Q-learning neural network.
		More layers can model more complex policies but may increase
		computation and training time.

config CPUFREQ_QLEARNING_ACTION_OFFSET
	int "offset of action in the Q-learning neural network"
	default 0
	---help---
		This is the index of the first action in frequency table.
		When calculating the action, the index of the frequency is
		adjusted by this offset.

endif

endif
```

## drivers/devfreq/Kconfig
```kconfig
#
# For a description of the syntax of this configuration file,
# see the file kconfig-language.txt in the NuttX tools repository.
#

config DEVFREQ
	bool "devfreq"
	default n
	---help---
		devfreq framwork, dynamic voltage frequency scaling(DVFS)
		for device

if DEVFREQ

config DEVFREQ_PROCFS
	bool "devfreq_procfs"
	default n
	depends on FS_PROCFS
	---help---
		devfreq procfs support

config DEVFREQ_PROCFS_QOS
	bool "devfreq_procfs_qos"
	default n
	depends on DEVFREQ_PROCFS
	---help---
		devfreq procfs show qos requests and their callers

config DEVFREQ_GOV_ONDEMAND
	bool "devfreq_gov_ondemand"
	default n
	depends on !SCHED_CPULOAD_NONE
	---help---
		devfreq_ondemand governor

if DEVFREQ_GOV_ONDEMAND

config DEVFREQ_SAMPLE_RATE
	int "the default sample rate (us) to get the cpuload"
	default 1000000
	---help---
		Ondemand sample rate

config DEVFREQ_LOAD_THRESHOLD
	int "the default cpu load threshold up to max cpu freq"
	default 80
	---help---
		Ondemand cpu load threshold

endif

config DEVFREQ_GOV_QLEARNING
	bool "devfreq_gov_qlearning"
	default n
	depends on !ARCH_PERF_EVENTS && PM
	---help---
		devfreq_qlearning governor

if DEVFREQ_GOV_QLEARNING

config DEVFREQ_QLEARNING_WAIT_TIME
	int "the default wait time (ms) between two samples"
	default 100
	---help---
		wait time between two samples

config DEVFREQ_QLEARNING_INIT_WAIT_TIME
	int "the default wait time (ms) for system boot"
	default PM_GOVERNOR_EXPLICIT_RELAX
	---help---
		wait for system boot, then read the initial parameters. Reading
		file will fail if system boot is not finished.

config DEVFREQ_QLEARNING_INIT_FREQ
	int "the default initial freq(KHz)"
	default 100000
	---help---
		initial freq of devfreq qlearning governor, before reading the
		parameters from file finished.

config DEVFREQ_QLEARNING_FILE_PATH
	string "File path of devfreq qlearning parameters"
	default "/etc/devfreq_qlearning_params.bin"
	---help---
		File path of devfreq qlearning parameters

config DEVFREQ_QLEARNING_MIN_FREQ
	int "the default min cpu freq(KHz)"
	default 32
	---help---
		min freq of devfreq qlearning governor, if current freq is lower
		than this value, qlearning algorithm will not run. It is a workaround
		to avoid high overhead cause by running algorithm at low frequency.

config DEVFREQ_QLEARNING_NEURONS_PER_LAYER
	int "number of neurons in each Q-learning layer"
	default 10
	---help---
		Number of neurons (or units) in each fully-connected layer of the
		Q-learning neural network. This also determines the size of weight
		matrices and bias vectors.

config DEVFREQ_QLEARNING_NUM_LAYERS
	int "number of layers in the Q-learning neural network"
	default 3
	---help---
		Number of fully-connected layers in the Q-learning neural network.
		More layers can model more complex policies but may increase
		computation and training time.

config DEVFREQ_QLEARNING_ACTION_OFFSET
	int "offset of action in the Q-learning neural network"
	default 0
	---help---
		This is the index of the first action in frequency table.
		When calculating the action, the index of the frequency is
		adjusted by this offset.

endif

choice
	prompt "cpufreq default governor"
	default CPUFREQ_DEFAULT_GOV_NULL

config CPUFREQ_DEFAULT_GOV_NULL
	bool "null"
	---help---
		disable cpufreq

config CPUFREQ_DEFAULT_GOV_PERFORMANCE
	bool "performance"
	---help---
		use devfreq_performance governor

config CPUFREQ_DEFAULT_GOV_POWERSAVE
	bool "powersave"
	---help---
		use devfreq_powersave governor

config CPUFREQ_DEFAULT_GOV_ONDEMAND
	bool "ondemand"
	depends on DEVFREQ_GOV_ONDEMAND
	---help---
		use devfreq_ondemand governor

config CPUFREQ_DEFAULT_GOV_QLEARNING
	bool "qlearning"
	depends on DEVFREQ_GOV_QLEARNING
	---help---
		use devfreq_qlearning governor

endchoice

config CPUFREQ_DEVICE_NAME
	string "cpufreq device name"
	default "cpu"
	depends on !CPUFREQ_DEFAULT_GOV_NULL
	---help---
		CPUFREQ device name, e.g. "cpu" or "cpu0"

endif
```

## drivers/hwtracing/Kconfig
```kconfig
#
# For a description of the syntax of this configuration file,
# see the file kconfig-language.txt in the NuttX tools repository.
#

menuconfig HWTRACING
	bool "Hwtracing Driver Support"
	default n
	---help---
		Hwtracing drivers support.

if HWTRACING

config HWTRACING_MAX_OUTPORT_NUM
	int "Max outport number of hwtracing device"
	default 2

config HWTRACING_TIMEOUT
	int "Timeout us for waiting register state change"
	default 100

endif # HWTRACING

source "drivers/hwtracing/coresight/Kconfig"
source "drivers/hwtracing/tricoreht/Kconfig"
```

## drivers/hwtracing/tricoreht/Kconfig
```kconfig
#
# For a description of the syntax of this configuration file,
# see the file kconfig-language.txt in the NuttX tools repository.
#
menuconfig TRICOREHT
	bool "Tricoreht Driver Support"
	default n
	---help---
		Tricoreht drivers support.

if TRICOREHT

config TRICOREHT_NOTE_DTU
	bool "Note tricoreht use dtu driver"
	select HWTRACING_NOTE
	default n

config TRICOREHT_TRIGGER_SECTION
	string "Ttricoreht trigger section"
	default ""
	---help---
		The section in which to place the trigger buffer.

endif # TRICOREHT
```

## drivers/pcie/Kconfig
```kconfig
#
# For a description of the syntax of this configuration file,
# see the file kconfig-language.txt in the NuttX tools repository.
#

menuconfig PCIE
	bool "Support for PCI-E Bus"
	default n
	---help---
		Enables support for the PCI-E bus.
		Backend bust be provided by per-arch or per-board implementation..

if PCIE
config PCIE_MAX_BDF
	hex "Maximum bdf to scan on PCI-E bus"
	default 0x10000
	---help---
		The maximum bdf number to be scaned on PCI-E bus

config MAX_IRQ_LINES
  int "Number of IRQ lines"
  default 128
  range 0 224
  help
    This option specifies the number of IRQ lines in the system. It
    determines the size of the _irq_to_interrupt_vector_table, which
    is used to track the association between vectors and IRQ numbers.

endif
```
