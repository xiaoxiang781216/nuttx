## arch/arm/src/arm_m/Kconfig
```kconfig
#
# For a description of the syntax of this configuration file,
# see the file kconfig-language.txt in the NuttX tools repository.
#

comment "ARM_M Configuration Options"

config ARM_ITMSYSLOG
	bool "Use ITM for syslog output"
	default n

if ARM_ITMSYSLOG

config ARM_ITMSYSLOG_PORT
	int "ITM SYSLOG Port"
	default 0
	range 0 31

config ARM_ITMSYSLOG_SWODIV
	int "ITM SYSLOG SWO divider"
	default 15
	range 1 8192

endif # ARM_ITMSYSLOG

config ARM_SYSTICK
	bool "SysTick timer driver"
	depends on TIMER
	default n
	---help---
		Enable SysTick timer driver.

config ARM_SYSTICK_IRQ_WQUEUE
	bool "attach irq by irq_attach_wqueue"
	default n
	depends on ARM_SYSTICK

if ARM_SYSTICK_IRQ_WQUEUE

config ARM_SYSTICK_IRQ_WQUEUE_PRIORITY
	int "SYSTICK IRQ WQUEUE PRIORITY"
	default 255
	range 0 255

config ARM_SYSTICK_IRQ_THREAD_STACK_SIZE
	int "SYSTICK IRQ THREAD STACK SIZE"
	default DEFAULT_TASK_STACKSIZE

endif # ARM_SYSTICK_IRQ_WQUEUE

if ARCH_ARMV7M

config ARMV7M_BASEPRI_WAR
	bool "Cortex-M7 r0p1 Errata 837070 Workaround"
	default n
	depends on ARCH_CORTEXM7
	---help---
		Enable workaround for r0p1 Errata 837070: Increasing priority using
		write to BASEPRI does not take effect immediately.

		This update is required to be serialized to the instruction stream
		meaning that after this update completes, it takes effect
		immediately and no exceptions of lower priority than the new boosted
		priority can preempt execution.  Because of this erratum, the
		priority boosting does not take place immediately, allowing the
		instruction after the MSR to be interrupted by an exception of
		lower priority than the new boosted priority. This effect is only
		limited to the next instruction. Subsequent instructions are
		guaranteed to see the new boosted priority.


endif # ARCH_ARMV7M

if ARCH_ARMV8M

config ARMV8M_STACKCHECK_HARDWARE
	bool "Check for stack overflow by stack pointer limit register"
	default y if DEBUG_FEATURES
	---help---
		This option signifies the CPU has the MSPLIM, PSPLIM registers.

		The stack pointer limit registers, MSPLIM, PSPLIM, limit the
		extend to which the Main and Process Stack Pointers, respectively,
		can descend. MSPLIM, PSPLIM are always present in ARMv8-M
		MCUs that implement the ARMv8-M Main Extension (Mainline).

		In an ARMv8-M Mainline implementation with the Security Extension
		the MSPLIM, PSPLIM registers have additional Secure instances.
		In an ARMv8-M Baseline implementation with the Security Extension
		the MSPLIM, PSPLIM registers have only Secure instances.

config ARMV8M_TRUSTZONE_HYBRID
	bool "Hybrid with secure and non-secure."
	default n
	depends on SMP
	---help---
		Enable the hybrid with secure and non-secure domain.
		In SMP mode, you can enable this configuration when one
		core supports secure and the other does not.

config ARMV8M_TRUSTZONE_CPU_BITMASK
	hex "Security support bitmap for multicore."
	depends on ARMV8M_TRUSTZONE_HYBRID
	default 0
	---help---
		Set Security bitmap for multicore, bit 0 means core 0.

config ARMV8M_CMSE
	bool "ARMv8-M Security Extensions"
	---help---
		Enable ARMv8-M Security Extensions.

endif # ARCH_ARMV8M
```

## arch/arm/src/armv7-m/Kconfig
```kconfig
#
# For a description of the syntax of this configuration file,
# see the file kconfig-language.txt in the NuttX tools repository.
#

comment "ARMv7-M Configuration Options"

config ARMV7M_BASEPRI_WAR
	bool "Cortex-M7 r0p1 Errata 837070 Workaround"
	default n
	depends on ARCH_CORTEXM7
	---help---
		Enable workaround for r0p1 Errata 837070: Increasing priority using
		write to BASEPRI does not take effect immediately.

		This update is required to be serialized to the instruction stream
		meaning that after this update completes, it takes effect
		immediately and no exceptions of lower priority than the new boosted
		priority can preempt execution.  Because of this erratum, the
		priority boosting does not take place immediately, allowing the
		instruction after the MSR to be interrupted by an exception of
		lower priority than the new boosted priority. This effect is only
		limited to the next instruction. Subsequent instructions are
		guaranteed to see the new boosted priority.

config ARMV7M_HAVE_ITCM
	bool
	default n

config ARMV7M_HAVE_DTCM
	bool
	default n

config ARMV7M_ITCM
	bool "Use ITCM"
	default n
	depends on ARMV7M_HAVE_ITCM

config ARMV7M_DTCM
	bool "Use DTCM"
	default n
	depends on ARMV7M_HAVE_DTCM

config ARMV7M_TARGET2_PREL
	bool "R_ARM_TARGET2 is PC relative"
	default CXX_EXCEPTION
	depends on LIBC_ARCH_ELF
	---help---
		Perform a PC relative relocation for relocation type R_ARM_TARGET2

config ARMV7M_HAVE_STACKCHECK
	bool
	default n

config ARMV7M_STACKCHECK
	bool "Check for stack overflow on each function call"
	default n
	depends on ARMV7M_HAVE_STACKCHECK
	select ARM_STACKCHECK
	---help---
		This check uses R10 to check for a stack overflow within each
		function call. This has performances and code size impacts, but it
		will be able to catch hard to find stack overflows.

		Currently only available only for the STM32, SAM3/4 and SAMA5D
		architectures.  The changes are not complex and patches for
		other architectures will be accepted.

		This option requires that you are using a GCC toolchain and that
		you also include -finstrument-functions and -ffixed-r10 in your
		CFLAGS when you compile. This addition to your CFLAGS should probably
		be added to the definition of the CFFLAGS in your board Make.defs file.

config ARMV7M_STACKCHECK_BREAKPOINT
	bool "Breakpoint on stack overflow"
	default n
	depends on ARMV7M_STACKCHECK
	select ARM_STACKCHECK_BREAKPOINT
	---help---
		If enabled, a hard-coded breakpoint will be inserted to the stack
		overflow trap. This is useful to stop the execution of the program
		and diagnose the issue before the hardfault handler is called (and
		context information is lost).

config ARMV7M_SYSTICK
	bool "SysTick timer driver"
	depends on TIMER
	select ARM_SYSTICK
	---help---
		Enable SysTick timer driver.
```

## arch/arm/src/armv8-m/Kconfig
```kconfig
#
# For a description of the syntax of this configuration file,
# see the file kconfig-language.txt in the NuttX tools repository.
#

comment "ARMv8-M Configuration Options"

config ARMV8M_HAVE_ITCM
	bool
	default n

config ARMV8M_HAVE_DTCM
	bool
	default n

config ARMV8M_ITCM
	bool "Use ITCM"
	default n
	depends on ARMV8M_HAVE_ITCM

config ARMV8M_DTCM
	bool "Use DTCM"
	default n
	depends on ARMV8M_HAVE_DTCM

config ARMV8M_TARGET2_PREL
	bool "R_ARM_TARGET2 is PC relative"
	default CXX_EXCEPTION
	depends on LIBC_ARCH_ELF
	---help---
		Perform a PC relative relocation for relocation type R_ARM_TARGET2

choice
	prompt "Select the stack protection Schema"
	default ARMV8M_STACKCHECK_HARDWARE if DEBUG_FEATURES
	default ARMV8M_STACKCHECK_NONE

config ARMV8M_STACKCHECK_NONE
	bool "Do not check for stack overflow"

config ARMV8M_STACKCHECK
	bool "Check for stack overflow on each function call"
	select ARM_STACKCHECK
	---help---
		This check uses R10 to check for a stack overflow within each
		function call. This has performances and code size impacts, but it
		will be able to catch hard to find stack overflows.

		Currently only available only for the STM32, SAM3/4 and SAMA5D
		architectures.  The changes are not complex and patches for
		other architectures will be accepted.

		This option requires that you are using a GCC toolchain and that
		you also include -finstrument-functions in your CFLAGS when you
		compile.  This addition to your CFLAGS should probably be added
		to the definition of the CFFLAGS in your board Make.defs file.

config ARMV8M_STACKCHECK_HARDWARE
	bool "Check for stack overflow by stack pointer limit register"
	---help---
		This option signifies the CPU has the MSPLIM, PSPLIM registers.

		The stack pointer limit registers, MSPLIM, PSPLIM, limit the
		extend to which the Main and Process Stack Pointers, respectively,
		can descend. MSPLIM, PSPLIM are always present in ARMv8-M
		MCUs that implement the ARMv8-M Main Extension (Mainline).

		In an ARMv8-M Mainline implementation with the Security Extension
		the MSPLIM, PSPLIM registers have additional Secure instances.
		In an ARMv8-M Baseline implementation with the Security Extension
		the MSPLIM, PSPLIM registers have only Secure instances.

endchoice

config ARMV8M_STACKCHECK_BREAKPOINT
	bool "Breakpoint on stack overflow"
	default n
	depends on ARMV8M_STACKCHECK
	select ARM_STACKCHECK_BREAKPOINT
	---help---
		If enabled, a hard-coded breakpoint will be inserted to the stack
		overflow trap. This is useful to stop the execution of the program
		and diagnose the issue before the hardfault handler is called (and
		context information is lost).

config ARMV8M_SYSTICK
	bool "SysTick timer driver"
	depends on TIMER
	select ARM_SYSTICK
	---help---
		Enable SysTick timer driver.

config ARMV8M_TRUSTZONE_HYBRID
	bool "Hybrid with secure and non-secure."
	default n
	depends on SMP
	---help---
		Enable the hybrid with secure and non-secure domain.
		In SMP mode, you can enable this configuration when one
		core supports secure and the other does not.

config ARMV8M_TRUSTZONE_CPU_BITMASK
	hex "Security support bitmap for multicore."
	depends on ARMV8M_TRUSTZONE_HYBRID
	default 0
	---help---
		Set Security bitmap for multicore, bit 0 means core 0.

config ARMV8M_CMSE
	bool "ARMv8-M Security Extensions"
	---help---
		Enable ARMv8-M Security Extensions.
```

## arch/arm/src/nrf51/Kconfig
```kconfig
#
# For a description of the syntax of this configuration file,
# see the file kconfig-language.txt in the NuttX tools repository.
#

if ARCH_CHIP_NRF51

config NRF51_LARGE
	bool "Enlarged memory for QEMU (16MB Flash, 1MB SRAM)"
	default n
	---help---
		Enable enlarged memory layout for modified QEMU. When enabled,
		the Flash size is set to 16MB and the SRAM size is set to 1MB,
		instead of the default 256KB Flash and 16KB SRAM. This option
		is only useful when running on a custom QEMU build that supports
		larger memory for nRF51.

config NRF51_UART
	bool
	default n

config NRF51_UART0
	bool "nRF51 UART0"
	default n
	select UART0_SERIALDRIVER
	select NRF51_UART
	---help---
		Enable support for nRF51 UART0

if NRF51_UART0

config NRF51_UART0_BASE
	hex "UART0 base address"
	default 0x40002000

config NRF51_UART0_IRQ
	int "UART0 IRQ number"
	default 18
	---help---
		IRQ number for UART0

config NRF51_UART0_BAUD
	int "UART0 baud rate"
	default 115200
	---help---
		Baud rate for UART0

config NRF51_UART0_RXBUFSIZE
	int "UART0 RX buffer size"
	default 256
	---help---
		Size of the RX buffer for UART0

config NRF51_UART0_TXBUFSIZE
	int "UART0 TX buffer size"
	default 256
	---help---
		Size of the TX buffer for UART0

config NRF51_UART0_SERIAL_CONSOLE
	bool "UART0 serial console"
	default n
	select SERIAL_CONSOLE
	select ARCH_HAVE_SERIAL_TERMIOS
	---help---
		Use UART0 as the serial console

endif # NRF51_UART0

config NRF51_UART1
	bool "nRF51 UART1"
	default n
	select UART1_SERIALDRIVER
	select NRF51_UART
	---help---
		Enable support for nRF51 UART1

if NRF51_UART1

config NRF51_UART1_BASE
	hex "UART1 base address"
	default 0x40003000

config NRF51_UART1_IRQ
	int "UART1 IRQ number"
	default 3
	---help---
		IRQ number for UART1

config NRF51_UART1_BAUD
	int "UART1 baud rate"
	default 115200
	---help---
		Baud rate for UART1

config NRF51_UART1_RXBUFSIZE
	int "UART1 RX buffer size"
	default 256
	---help---
		Size of the RX buffer for UART1

config NRF51_UART1_TXBUFSIZE
	int "UART1 TX buffer size"
	default 256
	---help---
		Size of the TX buffer for UART1

config NRF51_UART1_SERIAL_CONSOLE
	bool "UART1 serial console"
	default n
	select SERIAL_CONSOLE
	select ARCH_HAVE_SERIAL_TERMIOS
	---help---
		Use UART1 as the serial console

endif # NRF51_UART1
endif
```

## drivers/bch/Kconfig
```kconfig
#
# For a description of the syntax of this configuration file,
# see the file kconfig-language.txt in the NuttX tools repository.
#

menuconfig BCH
	bool "Block-to-Character (BCH) Support"
	default n
	---help---
		Contains logic that may be used to convert a block driver into
		a character driver.  This is the complementary conversion as that
		performed by loop.c.  See include/nuttx/drivers/drivers.h for
		registration information.

if BCH

config BCH_ENCRYPTION
	bool "Enable BCH encryption"
	default n
	depends on CRYPTO_AES

config BCH_ENCRYPTION_KEY_SIZE
	int "AES key size"
	default 16
	depends on BCH_ENCRYPTION

config BCH_BUFFER_ALIGNMENT
	int "Buffer aligned bytes"
	default 0

config BCH_DEVICE_READONLY
	bool "Set BCH device readonly"
	default n
	---help---
		Set bch devices read-only.  In addition to rejecting write opens,
		this compiles out the BCH write path entirely (bchlib_write.c, the
		bch_write() file operation and the sector write-back in
		bchlib_flushsector()) to save FLASH on read-only targets such as a
		verified-boot image that only reads its partitions.

endif # BCH
```
