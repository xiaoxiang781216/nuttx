## drivers/note/Kconfig
```kconfig
#
# For a description of the syntax of this configuration file,
# see the file kconfig-language.txt in the NuttX tools repository.
#

menu "Note Driver Support"

config DRIVERS_NOTE
	bool
	---help---
		Note Driver Support, enable this option to enable note driver.

config DRIVERS_NOTE_MAX
	int "Maximum number of sched_note drivers"
	default 1
	---help---
		sched_note supports the maximum number of drivers

config DRIVERS_NOTE_CPUID
	int "Note CPU ID"
	depends on UP
	default 0
	---help---
		The value used to mark CPU ID in the note data.
		When SMP or BMP is disabled, CPU ID is always 0. In order to
		distinguish between valid CPU ID and invalid CPU ID
		in the note data, this option can be used to set a
		specific value as the CPU ID.

config DRIVERS_NOTE_CLOCKID
	int "Select ClockId to display timestamp in notecomm"
	default -1
	---help---
		If -1 means disable timestamp add note comm.
		CLOCK_REALTIME, CLOCK_MONOTONIC etc. clockID

config DRIVERS_NOTE_RATELIMIT_INTERVAL
	int "NOTE rate limiting interval"
	default 0
	---help---
		"The size of the time window. 0 means no rate limiting"

config DRIVERS_NOTE_RATELIMIT_BURST
	int "NOTE rate limiting burst"
	default 0
	---help---
		"The burst traffic allowed within the window."

config DRIVERS_NOTE_DEFAULT_LEVEL
	int "NOTE driver default level"
	range 0 7
	default 7
	depends on SCHED_INSTRUMENTATION_DUMP
	---help---
		The note driver default level for SCHED_INSTRUMENTATION_DUMP
		Refer to syslog for level definition.
		LOG_EMERG     0  /* System is unusable */
		LOG_ALERT     1  /* Action must be taken immediately */
		LOG_CRIT      2  /* Critical conditions */
		LOG_ERR       3  /* Error conditions */
		LOG_WARNING   4  /* Warning conditions */
		LOG_NOTICE    5  /* Normal, but significant, condition */
		LOG_INFO      6  /* Informational message */
		LOG_DEBUG     7  /* Debug-level message */

config DRIVERS_NOTERAM
	bool "Note RAM driver"
	select DRIVERS_NOTE
	default SCHED_INSTRUMENTATION
	---help---
		If this option is selected, then in-memory buffering logic is
		enabled to capture scheduler instrumentation data.  This has
		the advantage that (1) the platform logic does not have to provide
		the sched_note_* interfaces described for the previous settings.
		Instead, the buffering logic catches all of these.  It encodes
		timestamps the scheduler note and adds the note to an in-memory,
		circular buffer.  And (2) buffering the scheduler instrumentation
		data (versus performing some output operation) minimizes the impact
		of the instrumentation on the behavior of the system. If the in-memory
		buffer becomes full, then older notes are overwritten by newer notes.

		A character driver is provided which can be used by an application
		to read data from the in-memory, scheduler instrumentation "note"
		buffer.

		NOTE: This option is not available if critical sections are being
		monitored (nor if spinlocks are being monitored in SMP configuration)
		because there would be a logical error in the design in those cases.
		That error is that these interfaces call enter_ and leave_critical_section
		(which use spinlocks in SMP mode).  That means that each call to
		sched_note_get() causes several additional entries to be added from
		the note buffer in order to remove one entry.

if DRIVERS_NOTERAM

config DRIVERS_NOTERAM_BUFSIZE
	int "Note RAM buffer size"
	default 2048
	---help---
		The size of the in-memory, circular instrumentation buffer (in bytes).

config DRIVERS_NOTERAM_SECTION_SHARED
	bool "Note RAM section shared in the BMP"
	depends on BMP
	default y
	---help---
		In the BMP, is the noteram section shared among multiple cores?
		If the noteram section is shared among multiple cores, there will
		be only one global buffer. If each core has its own noteram section,
		then the DRIVERS_NOTERAM_SECTION must be configured as a percpu
		buffer, which is usually supported by the hardware.

config DRIVERS_NOTERAM_SECTION
	string "Note RAM section"
	depends on !BMP || DRIVERS_NOTERAM_SECTION_SHARED
	---help---
		Enable section information.

config DRIVERS_NOTERAM_DEFAULT_NOOVERWRITE
	bool "Disable overwrite by default"
	default n
	---help---
		Disables overwriting old notes in the circular buffer when the buffer
		is full by default. This is useful to keep instrumentation data of the
		beginning of a system boot.

config DRIVERS_NOTERAM_CRASH_DUMP
	bool "Dump noteram buffer on panic"
	depends on SYSLOG
	default n
	---help---
		If this option is enabled, dump all contents when a crash occurs.

config DRIVERS_NOTERAM_POLLTIMEOUT_MS
	int "The timeout ms if poll requested and no data avaliable"
	default 0
	---help---
		Default 0 to disable this feature, positive value (ms) to make noteram trigger a
		wdog to enable idle timeout notify poll waiter.

config DRIVERS_NOTERAM_FILTER_DEFAULT_MODE
	hex "Note RAM filter mode"
	depends on SCHED_INSTRUMENTATION_FILTER
	default SCHED_INSTRUMENTATION_FILTER_DEFAULT_MODE
	---help---
		Filter mode bitmask for the static noteram instance.
		Each bit corresponds to a note_type_e value; a set bit
		rejects that type.

config DRIVERS_NOTERAM_CPUSET
	hex "Note RAM CPU set"
	depends on !UP && SCHED_INSTRUMENTATION_FILTER
	default SCHED_INSTRUMENTATION_CPUSET
	---help---
		CPU set for noteram

endif # DRIVERS_NOTERAM

config DRIVERS_NOTE_STRIP_FORMAT
	bool "Strip sched_note_printf format string"
	---help---
		Strip sched_note_printf format string.

config DRIVERS_NOTELOWEROUT
	bool "Note lower output"
	select DRIVERS_NOTE
	default n
	---help---
		Note uses lower output.

if DRIVERS_NOTELOWEROUT

config DRIVERS_NOTELOWEROUT_FILTER_DEFAULT_MODE
	hex "Note lower output filter mode"
	depends on SCHED_INSTRUMENTATION_FILTER
	default SCHED_INSTRUMENTATION_FILTER_DEFAULT_MODE
	---help---
		Filter mode for notelowerout

config DRIVERS_NOTELOWEROUT_CPUSET
	hex "Note lower output CPU set"
	depends on !UP && SCHED_INSTRUMENTATION_FILTER
	default SCHED_INSTRUMENTATION_CPUSET
	---help---
		CPU set for notelowerout

endif # DRIVERS_NOTELOWEROUT

config DRIVERS_NOTEFILE
	bool "Note file driver"
	select DRIVERS_NOTE
	---help---
		The Note driver output to file.

config DRIVERS_NOTEFILE_FILTER_DEFAULT_MODE
	hex "Note file driver filter mode"
	depends on DRIVERS_NOTEFILE && SCHED_INSTRUMENTATION_FILTER
	default SCHED_INSTRUMENTATION_FILTER_DEFAULT_MODE
	---help---
		Filter mode for notefile

config DRIVERS_NOTEFILE_CPUSET
	hex "Note file driver CPU set"
	depends on DRIVERS_NOTEFILE && !UP && SCHED_INSTRUMENTATION_FILTER
	default SCHED_INSTRUMENTATION_CPUSET
	---help---
		CPU set for notefile

config DRIVERS_NOTEFILE_PATH
	string "Note file path"
	depends on DRIVERS_NOTEFILE
	default "/dev/ttyS1"
	---help---
		The Note driver output to file path.

config DRIVERS_NOTELOG
	bool "Note syslog driver"
	select DRIVERS_NOTE
	---help---
		The Note driver output to syslog.

config DRIVERS_NOTELOG_FILTER_DEFAULT_MODE
	hex "Note syslog driver filter mode"
	depends on DRIVERS_NOTELOG && SCHED_INSTRUMENTATION_FILTER
	default SCHED_INSTRUMENTATION_FILTER_DEFAULT_MODE
	---help---
		Filter mode for notelog

config DRIVERS_NOTELOG_CPUSET
	hex "Note syslog driver CPU set"
	depends on DRIVERS_NOTELOG && !UP && SCHED_INSTRUMENTATION_FILTER
	default SCHED_INSTRUMENTATION_CPUSET
	---help---
		CPU set for notelog

config DRIVERS_NOTESNAP
	bool "Last scheduling information"
	select DRIVERS_NOTE
	default n
	---help---
		Record the last scheduling information.

if DRIVERS_NOTESNAP

config DRIVERS_NOTESNAP_FILTER_DEFAULT_MODE
	hex "Note snap driver filter mode"
	depends on SCHED_INSTRUMENTATION_FILTER
	default SCHED_INSTRUMENTATION_FILTER_DEFAULT_MODE
	---help---
		Filter mode for notesnap

config DRIVERS_NOTESNAP_CPUSET
	hex "Note snap driver CPU set"
	depends on !UP && SCHED_INSTRUMENTATION_FILTER
	default SCHED_INSTRUMENTATION_CPUSET
	---help---
		CPU set for notesnap

config DRIVERS_NOTESNAP_NBUFFERS
	int "Number of last scheduling information buffers"
	default 128
	---help---
		Number of last scheduling information buffers.

config DRIVERS_NOTESNAP_CRASH_DUMP
	bool "Dump notesnap buffer on panic"
	depends on SYSLOG
	default n
	---help---
		If this option is enabled, dump all contents when a crash occurs.

endif

config DRIVERS_NOTEITM
	bool "Note ITM driver"
	depends on CORESIGHT_ITM
	default n
	---help---
		The note driver output to ITM.

config DRIVERS_NOTERPMSG_SERVER
	bool "Enable RPMSG server for NOTE"
	select DRIVERS_NOTE
	default n
	depends on RPMSG
	---help---
		Use rpmsg to receive message from remote proc.

config DRIVERS_NOTERPMSG
	bool "Note to RPMSG"
	select DRIVERS_NOTE
	depends on RPMSG
	depends on SCHED_WORKQUEUE
	default n
	---help---
		Use the rpmsg as a Note output device, send message to remote proc.

if DRIVERS_NOTERPMSG

config DRIVERS_NOTERPMSG_FILTER_DEFAULT_MODE
	hex "Note RPMSG client filter mode"
	depends on SCHED_INSTRUMENTATION_FILTER
	default SCHED_INSTRUMENTATION_FILTER_DEFAULT_MODE
	---help---
		Filter mode for noterpmsg

config DRIVERS_NOTERPMSG_CPUSET
	hex "Note RPMSG client CPU set"
	depends on !UP && SCHED_INSTRUMENTATION_FILTER
	default SCHED_INSTRUMENTATION_CPUSET
	---help---
		CPU set for noterpmsg

config DRIVERS_NOTERPMSG_BUFSIZE
	int "Note RPMSG client buffer size"
	default 1024
	---help---
		The size of the client buffer (in bytes)

config DRIVERS_NOTERPMSG_SERVER_NAME
	string "The name of Note Rpmsg Server"
	default "ap"
	---help---
		The proc name of rpmsg server. Client sends message to
		specified name of remote proc.

config DRIVERS_NOTERPMSG_WORK_DELAY
	int "NOTE RPMSG work delay(ms)"
	default 100

endif

config DRIVERS_NOTENET
	bool "Note to netdev"
	select DRIVERS_NOTE
	depends on NETDEVICES && NET_NETPOLL
	default n
	---help---
		Use the netdev as a Note output device

if DRIVERS_NOTENET

config DRIVERS_NOTENET_INTF
	string "Note netdev interface"
	default "eth0"
	---help---
		Network interface used for netdev Note.

config DRIVERS_NOTENET_IPADDR
	hex "Note netdev destination IP addres"
	default 0xffffffff
	---help---
		Address where where netdev sends Note output.
		Default: broadcast IP address.

config DRIVERS_NOTENET_MAC
	string "Note netdev destination MAC addres"
	default "ff:ff:ff:ff:ff:ff"
	---help---
		MAC address where where netdev sends Note output.
		Default: broadcast MAC address.

config DRIVERS_NOTENET_PORT
	int "Note netdev port"
	default 50000
	---help---
		UDP port for Note output.

config DRIVERS_NOTENET_FILTER_DEFAULT_MODE
	hex "Note netdev lower output filter mode"
	depends on SCHED_INSTRUMENTATION_FILTER
	default SCHED_INSTRUMENTATION_FILTER_DEFAULT_MODE
	---help---
		Filter mode for note netdev

config DRIVERS_NOTENET_CPUSET
	hex "Note netdev lower output CPU set"
	depends on !UP && SCHED_INSTRUMENTATION_FILTER
	default SCHED_INSTRUMENTATION_CPUSET
	---help---
		CPU set for note netdev

config DRIVERS_NOTENET_WORK_DELAY
	int "NOTE netdev work delay (ms)"
	default 100

endif

endmenu # Note Driver Support
```

## drivers/rptun/Kconfig
```kconfig
#
# For a description of the syntax of this configuration file,
# see the file kconfig-language.txt in the NuttX tools repository.
#

menuconfig RPTUN
	bool "Remote Proc Tunnel Driver Support"
	default n
	select RPMSG_VIRTIO
	---help---
		RPTUN driver is used for multi-cores' communication.

if RPTUN

choice RPTUN_AUTO_RESET
	prompt "rptun auto reset peer"
	default RPTUN_AUTO_RESET_IN_REBOOT_NOTIFIER if BMP
	default RPTUN_AUTO_RESET_IN_PANIC_NOTIFIER if !BMP

config RPTUN_AUTO_RESET_DISABLE
	bool "rptun auto reset feature disabled"

config RPTUN_AUTO_RESET_IN_PANIC_NOTIFIER
	bool "rptun panic other core in panic notifier"
	---help---
		Panic peer in the panic notifier and Reboot/Poweroff peer in
		the reboot notifier. This mode is used for the case that the
		main core do the coredump after panic all the peer cores.

config RPTUN_AUTO_RESET_IN_REBOOT_NOTIFIER
	bool "rptun panic other core in reboot notifier"
	---help---
		Panic/Reboot/Poweroff peer all in the reboot notifier.
		This mode is used for the case that all the core do its
		coredump by itself.

endchoice # RPTUN_AUTO_RESET

config RPTUN_REMOTE_PANIC_SILENT
	bool "Silence syslog on remote-triggered panic"
	default n
	---help---
		When a remote core triggers a panic on this core, silence
		all syslog output by setting logmask to LOG_NONE. The log
		mask is restored at PANIC_KERNEL_FINAL before coredump and
		RAMLOG dump, so only the originating core's crash log is
		printed during the panic sequence.

config RPTUN_BMP
	bool "rptun bmp support"
	default n
	---help---
		This is a rptun driver for communications in bmp
		environments. With this driver, Each ends communicate with each
		other by using the native rpmsg
		or various Rpmsg services have been implemented in NuttX.

config RPTUN_IVSHMEM
	bool "rptun ivshmem support"
	default n
	depends on PCI_IVSHMEM
	---help---
		This is rptun driver based on pci ivshmem.

if RPTUN_IVSHMEM

config RPTUN_IVSHMEM_NAME
	string "rptun ivshmem name"
	---help---
		Using this config to custom the rptun ivshmem cpuname and role,
		using ";" to split the names.
		For example, if RPTUN_IVSHMEM_CPUNAME = "0:cpu1:m;1:cpu2:s" and pass
		two ivshmem devices to the qemu, we will get two rptun ivshmem
		drivers with ivshmem device match id: [0, 1],
		remote cpu names: ["cpu1", "cpu2"] and roles: ["master", "slave"']

config RPTUN_IVSHMEM_BUFFSIZE
	int "rptun ivshmem rpmsg buffer size"
	default 2048
	---help---
		The rpmsg buffer size in resource table, the RX and TX buffer size
		are same for now.

config RPTUN_IVSHMEM_BUFFNUM
	int "rptun ivshmem rpmsg buffer number"
	default 8
	---help---
		The rpmsg buffer number in resource table, the RX and TX buffer number
		are same for now.

config RPTUN_IVSHMEM_RPMB_PATH
	string "rptun ivshmem backend eMMC RPMB device path"
	depends on DRIVERS_VHOST_RPMB
	default "/dev/mmcsd0rpmb"
	---help---
		Path of the backend eMMC RPMB partition opened by the vhost-rpmb
		driver on the device side. It is published into the RPMB vdev
		config space (struct vhost_rpmb_config_s) of the ivshmem resource
		table so the vhost-rpmb probe can open the real RPMB block device.

endif

config RPTUN_START_SYNC
	bool "rptun start devices synchronously"
	default n
	---help---
		By default rptun spawns a short lived "rptun" kernel thread on every
		start to bring the remote proc up and to wait for the peer to publish
		VIRTIO_CONFIG_STATUS_DRIVER_OK.  Each start/stop cycle therefore
		allocates and releases a TCB and a stack, and the stop path has to
		SIGKILL the thread out of its peer wait.

		Enable this option to run the whole sequence inline in the caller's
		context instead.  No thread is created and a start/stop cycle performs
		no dynamic allocation at all.

		Be aware of the trade-off: the caller blocks until the peer is ready.
		With RPTUN_IS_AUTOSTART this stalls board bring-up, and when entered
		through RPTUNIOC_START (rptun_boot()) the global rptun lock is held for
		the whole wait, which blocks rptun_reset()/rptun_poweroff() on every
		rptun instance, including from the panic notifier.

		Only select this when the peer is known to be up before this side
		starts, or when stalling the caller is acceptable.

config RPTUN_PRIORITY
	int "rptun thread priority"
	default 224

config RPTUN_STACKSIZE
	int "rptun stack size"
	default 4096

config RPTUN_STATUS_TIMEOUT_MS
	int "rptun status timeout ms"
	default 5000

config RPTUN_LOADER
	bool "rptun loader support"
	default n

config RPTUN_TRACE_DUMP
	bool "rptun dump remote core's syslog"
	default n

endif # RPTUN
```
